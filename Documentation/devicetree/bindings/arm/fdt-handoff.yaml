## Documentation/devicetree/bindings/power/supply/southchip,sc8517.yaml
```yaml
# SPDX-License-Identifier: GPL-2.0-only OR BSD-2-Clause
%YAML 1.2
---
$id: http://devicetree.org/schemas/power/supply/southchip,sc8517.yaml#
$schema: http://devicetree.org/meta-schemas/core.yaml#

title: Southchip SC8517 direct charger and SuperVOOC PHY

maintainers:
  - Sebastian Reichel <sre@kernel.org>

description: |
  The SC8517 negotiates SuperVOOC charging and connects the adapter to a
  two-cell battery pack. Two external switches route USB D+/D- between the
  application processor and the charging PHY. A discrete fuel gauge provides
  pack voltage, current, temperature, and state of charge. The Qualcomm PMIC
  GLINK USB power supply detects the cable and controls the parallel buck path.

properties:
  compatible:
    const: southchip,sc8517

  reg:
    maxItems: 1

  interrupts:
    maxItems: 1

  fuel-gauge:
    $ref: /schemas/types.yaml#/definitions/phandle
    description: Fuel gauge reporting the two-cell pack, including pack voltage.

  switch-ctrl-gpios:
    maxItems: 1
    description: Route the USB lines to the charging PHY when asserted.

  vphy-switch-gpios:
    maxItems: 1
    description: Select the SuperVOOC charging path when asserted.

required:
  - compatible
  - reg
  - interrupts
  - fuel-gauge
  - switch-ctrl-gpios
  - vphy-switch-gpios

additionalProperties: false

examples:
  - |
    #include <dt-bindings/gpio/gpio.h>
    #include <dt-bindings/interrupt-controller/irq.h>

    i2c {
        #address-cells = <1>;
        #size-cells = <0>;

        charger@69 {
            compatible = "southchip,sc8517";
            reg = <0x69>;
            interrupt-parent = <&tlmm>;
            interrupts = <9 IRQ_TYPE_EDGE_FALLING>;
            fuel-gauge = <&fuel_gauge>;
            switch-ctrl-gpios = <&pm8550b_gpios 2 GPIO_ACTIVE_HIGH>;
            vphy-switch-gpios = <&pm8550b_gpios 8 GPIO_ACTIVE_HIGH>;
        };
    };
```

## Documentation/devicetree/bindings/power/supply/southchip,sc8547.yaml
```yaml
# SPDX-License-Identifier: GPL-2.0-only OR BSD-2-Clause
%YAML 1.2
---
$id: http://devicetree.org/schemas/power/supply/southchip,sc8547.yaml#
$schema: http://devicetree.org/meta-schemas/core.yaml#

title: Southchip SC8547D 2:1 charge pump

maintainers:
  - Sebastian Reichel <sre@kernel.org>

description: |
  The SC8547D is a 2:1 switched-capacitor charge pump for single-cell
  batteries. It measures its input, output and battery, and stops on its
  own protection limits or when its watchdog expires. Some boards also use
  its built-in VOOC PHY, which talks to the adapter over USB D+/D- while a
  direct charging driver runs the pump.

properties:
  compatible:
    const: southchip,sc8547d

  reg:
    maxItems: 1

  interrupts:
    maxItems: 1

  southchip,vbat-ovp-microvolt:
    description: Battery overvoltage limit.
    minimum: 3500000
    maximum: 5075000
    multipleOf: 25000
    default: 4650000

  southchip,vbus-ovp-microvolt:
    description: Input overvoltage limit.
    minimum: 6000000
    maximum: 12350000
    multipleOf: 50000
    default: 10000000

  southchip,ibus-ocp-microamp:
    description: Input overcurrent limit.
    minimum: 1200000
    maximum: 5700000
    multipleOf: 300000
    default: 3600000

  southchip,switching-frequency-hz:
    enum: [500000, 600000]
    default: 500000

  southchip,always-otg-en:
    type: boolean
    description: Keep the OTG enable bit set at all times.

  vooc-phy:
    type: object
    description: The built-in VOOC PHY, used by a direct charging driver.
    additionalProperties: false

    properties:
      mux-states:
        description: Routes USB D+/D- from the connector to the PHY.
        maxItems: 1

      io-channels:
        items:
          - description: USB connector thermistor
          - description: Battery connector thermistor
          - description: Board thermistor
          - description: Charge pump MOSFET thermistor

      io-channel-names:
        items:
          - const: usb-connector
          - const: battery-connector
          - const: board
          - const: mos

      southchip,secondary-pump:
        $ref: /schemas/types.yaml#/definitions/phandle
        description: A second SC8547D sharing the charging current.

      oneplus,svooc-battery-curve:
        $ref: /schemas/types.yaml#/definitions/uint32-matrix
        description:
          The battery curve the SuperVOOC adapter reads before charging, as
          three pairs of battery voltage in microvolts and current in
          microamps.
        minItems: 3
        maxItems: 3
        items:
          items:
            - minimum: 3404000
              maximum: 4664000
            - minimum: 100000
              maximum: 12700000
              multipleOf: 100000

    required:
      - mux-states
      - io-channels
      - io-channel-names
      - oneplus,svooc-battery-curve

required:
  - compatible
  - reg
  - interrupts

additionalProperties: false

examples:
  - |
    #include <dt-bindings/interrupt-controller/irq.h>

    i2c {
        #address-cells = <1>;
        #size-cells = <0>;

        charge-pump@6a {
            compatible = "southchip,sc8547d";
            reg = <0x6a>;
            interrupt-parent = <&tlmm>;
            interrupts = <0 IRQ_TYPE_EDGE_FALLING>;
            southchip,vbat-ovp-microvolt = <4850000>;
            southchip,vbus-ovp-microvolt = <10500000>;
            southchip,ibus-ocp-microamp = <3600000>;
            southchip,always-otg-en;

            vooc-phy {
                mux-states = <&usbss 1>;
                io-channels = <&adc 0x2747>, <&adc 0x2744>,
                              <&adc 0x274d>, <&adc 0x274b>;
                io-channel-names = "usb-connector", "battery-connector",
                                   "board", "mos";
                southchip,secondary-pump = <&second_pump>;
                oneplus,svooc-battery-curve = <4664000 1100000>,
                                              <4664000 2600000>,
                                              <3414000 7300000>;
            };
        };
    };
```

## Documentation/devicetree/bindings/regulator/mediatek,mt6368-regulator.yaml
```yaml
# SPDX-License-Identifier: (GPL-2.0-only OR BSD-2-Clause)
%YAML 1.2
---
$id: http://devicetree.org/schemas/regulator/mediatek,mt6368-regulator.yaml#
$schema: http://devicetree.org/meta-schemas/core.yaml#

title: MediaTek MT6368 PMIC LDO regulators

maintainers:
  - Doctor Logix <doctor.logix@gmail.com>

description:
  The MT6368 SPMI PMIC has LDO regulators for the connectivity, audio, card,
  touch and fingerprint rails of MT6897 boards. Each LDO is a child node named
  after it.

properties:
  compatible:
    const: mediatek,mt6368-regulator

patternProperties:
  "^v(usb|aux18|rf13-aif|rf18-aif|ant18|ibr|io28|fp|tp|mch|mc|aud18|cn33-[12]|efuse|sim2)$":
    type: object
    $ref: regulator.yaml#
    unevaluatedProperties: false
    properties:
      regulator-allowed-modes:
        description: Operating modes, 0 for normal and 2 for low power.
        items:
          enum: [0, 2]

required:
  - compatible

additionalProperties: false

examples:
  - |
    regulators {
      compatible = "mediatek,mt6368-regulator";

      vcn33-1 {
        regulator-min-microvolt = <3300000>;
        regulator-max-microvolt = <3300000>;
      };
    };
```

## Documentation/devicetree/bindings/soc/mediatek/mediatek,mt6897-consys.yaml
```yaml
# SPDX-License-Identifier: (GPL-2.0-only OR BSD-2-Clause)
%YAML 1.2
---
$id: http://devicetree.org/schemas/soc/mediatek/mediatek,mt6897-consys.yaml#
$schema: http://devicetree.org/meta-schemas/core.yaml#

title: MediaTek MT6897 connectivity subsystem

maintainers:
  - Doctor Logix <doctor.logix@gmail.com>

description:
  The connectivity subsystem holds the Wi-Fi, Bluetooth and GNSS cores of
  the SoC behind a shared infrastructure, and drives a separate radio die
  over a few dedicated pins. The secure world performs its low-level
  power-on. The radios are child nodes in its register window.

properties:
  compatible:
    const: mediatek,mt6897-consys

  reg:
    maxItems: 1

  ranges: true

  "#address-cells":
    const: 1

  "#size-cells":
    const: 1

  clocks:
    items:
      - description:
          The radio die's reference clock, 26 or 52 MHz, from the PMIC's
          clock buffer or from a TCXO.

  mediatek,tcxo:
    type: boolean
    description:
      The reference clock comes from a TCXO rather than the PMIC's clock
      buffer.

  power-domains:
    maxItems: 1

  memory-region:
    maxItems: 1
    description:
      The memory where the bootloader loads the radios' firmware.

  pinctrl-names:
    items:
      - const: default
      - const: sleep

  pinctrl-0: true
  pinctrl-1: true

  vcn13-supply:
    description: The 1.3 V supply of the radio die.

  vrf-io18-supply:
    description: The 1.8 V supply of the radio die's interface.

  vant18-supply:
    description: The 1.8 V supply of the antenna switches.

  vcn33-1-supply:
    description: The first 3.3 V supply of the front end.

  vcn33-2-supply:
    description: The second 3.3 V supply of the front end.

patternProperties:
  "^wifi@[0-9a-f]+$":
    type: object
    $ref: /schemas/net/wireless/mediatek,mt76.yaml#
    unevaluatedProperties: false

required:
  - compatible
  - reg
  - ranges
  - "#address-cells"
  - "#size-cells"
  - clocks
  - power-domains
  - pinctrl-names
  - pinctrl-0
  - pinctrl-1
  - vcn13-supply
  - vrf-io18-supply
  - vant18-supply
  - vcn33-1-supply
  - vcn33-2-supply

additionalProperties: false

examples:
  - |
    #include <dt-bindings/interrupt-controller/arm-gic.h>
    #include <dt-bindings/power/mediatek,mt6897-power.h>

    soc {
        #address-cells = <2>;
        #size-cells = <2>;

        connectivity@18000000 {
            compatible = "mediatek,mt6897-consys";
            reg = <0 0x18000000 0 0x700000>;
            ranges = <0 0 0x18000000 0x700000>;
            #address-cells = <1>;
            #size-cells = <1>;
            clocks = <&conn_clk>;
            power-domains = <&spm MT6897_POWER_DOMAIN_CONN>;
            memory-region = <&consys_firmware>;
            pinctrl-names = "default", "sleep";
            pinctrl-0 = <&conn_pins>;
            pinctrl-1 = <&conn_sleep_pins>;
            vcn13-supply = <&vcn13>;
            vrf-io18-supply = <&vrf_io18>;
            vant18-supply = <&vant18>;
            vcn33-1-supply = <&vcn33_1>;
            vcn33-2-supply = <&vcn33_2>;

            wifi@0 {
                compatible = "mediatek,mt6897-wifi";
                reg = <0 0x700000>;
                interrupts = <GIC_SPI 889 IRQ_TYPE_LEVEL_HIGH>;
                memory-region = <&wifi_dma>;
            };
        };
    };
```

## Documentation/devicetree/bindings/sound/nxp,tfa987x.yaml
```yaml
# SPDX-License-Identifier: (GPL-2.0-only OR BSD-2-Clause)
%YAML 1.2
---
$id: http://devicetree.org/schemas/sound/nxp,tfa987x.yaml#
$schema: http://devicetree.org/meta-schemas/core.yaml#

title: NXP/Goodix TFA9872, TFA9873 and TFA9874 (TFA2) Audio Amplifiers

maintainers:
  - Shandorman <98683030+jiganomegsdfdf@users.noreply.github.com>

description:
  Mono class-D speaker amplifiers with a boost converter and no DSP,
  controlled over I2C and fed over I2S/TDM.

allOf:
  - $ref: dai-common.yaml#

properties:
  compatible:
    enum:
      - nxp,tfa9872
      - nxp,tfa9873
      - nxp,tfa9874

  reg:
    maxItems: 1

  '#sound-dai-cells':
    const: 0

  reset-gpios:
    maxItems: 1

  vddd-supply:
    description: Digital supply.

  nxp,tdm-slot:
    $ref: /schemas/types.yaml#/definitions/uint32
    maximum: 15
    default: 0
    description: Slot of the I2S/TDM frame that the amplifier plays.

  sound-name-prefix: true

required:
  - compatible
  - reg
  - '#sound-dai-cells'

unevaluatedProperties: false

examples:
  - |
    #include <dt-bindings/gpio/gpio.h>
    i2c {
      #address-cells = <1>;
      #size-cells = <0>;

      audio-codec@34 {
        compatible = "nxp,tfa9873";
        reg = <0x34>;
        reset-gpios = <&tlmm 56 GPIO_ACTIVE_HIGH>;
        vddd-supply = <&vreg_l15b_1p8>;
        sound-name-prefix = "Top";
        #sound-dai-cells = <0>;
      };

      audio-codec@35 {
        compatible = "nxp,tfa9873";
        reg = <0x35>;
        reset-gpios = <&tlmm 173 GPIO_ACTIVE_HIGH>;
        vddd-supply = <&vreg_l15b_1p8>;
        nxp,tdm-slot = <1>;
        sound-name-prefix = "Bottom";
        #sound-dai-cells = <0>;
      };
    };
```
