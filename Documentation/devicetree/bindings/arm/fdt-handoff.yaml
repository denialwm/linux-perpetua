## Documentation/devicetree/bindings/media/i2c/ovti,ov50e40.yaml
```yaml
# SPDX-License-Identifier: (GPL-2.0-only OR BSD-2-Clause)
%YAML 1.2
---
$id: http://devicetree.org/schemas/media/i2c/ovti,ov50e40.yaml#
$schema: http://devicetree.org/meta-schemas/core.yaml#

title: OmniVision OV50E40 Image Sensor

description:
  OmniVision OV50E40 is a 50MP image sensor. The sensor is controlled over a
  serial camera control bus protocol, the widest output image frame size
  is 8192x6144, data output format is RAW10 transferred over a 3-trio
  MIPI C-PHY interface.

maintainers:
  - Doctor Logix <doctor.logix@gmail.com>

allOf:
  - $ref: /schemas/media/video-interface-devices.yaml#

properties:
  compatible:
    const: ovti,ov50e40

  reg:
    maxItems: 1

  clocks:
    description: MCLK supply clock.
    maxItems: 1

  reset-gpios:
    description: Active low GPIO connected to the XSHUTDOWN pad of the sensor.
    maxItems: 1

  avdd-supply:
    description: Analogue voltage supply.

  dvdd-supply:
    description: Digital core voltage supply, 1.1 volts.

  dovdd-supply:
    description: Digital I/O voltage supply.

  port:
    $ref: /schemas/graph.yaml#/$defs/port-base
    additionalProperties: false

    properties:
      endpoint:
        $ref: /schemas/media/video-interfaces.yaml#
        unevaluatedProperties: false

        properties:
          bus-type:
            const: 1

          data-lanes:
            items:
              - const: 1
              - const: 2
              - const: 3

        required:
          - bus-type
          - data-lanes
          - link-frequencies

required:
  - compatible
  - reg
  - clocks
  - port

unevaluatedProperties: false

examples:
  - |
      #include <dt-bindings/gpio/gpio.h>
      #include <dt-bindings/media/video-interfaces.h>

      i2c {
          #address-cells = <1>;
          #size-cells = <0>;

          camera@36 {
              compatible = "ovti,ov50e40";
              reg = <0x36>;
              clocks = <&camera_mclk 2>;
              assigned-clocks = <&camera_mclk 2>;
              assigned-clock-rates = <24000000>;
              reset-gpios = <&gpio1 3 GPIO_ACTIVE_LOW>;
              avdd-supply = <&vreg_cam_ana>;
              dvdd-supply = <&vreg_1p1>;
              dovdd-supply = <&vreg_cam_io>;

              port {
                  endpoint {
                      bus-type = <MEDIA_BUS_TYPE_CSI2_CPHY>;
                      data-lanes = <1 2 3>;
                      link-frequencies = /bits/ 64 <1408000000>;
                      remote-endpoint = <&mipi_csi2_ep>;
                  };
              };
          };
      };
...
```

## Documentation/devicetree/bindings/media/i2c/sony,imx890.yaml
```yaml
# SPDX-License-Identifier: (GPL-2.0-only OR BSD-2-Clause)
%YAML 1.2
---
$id: http://devicetree.org/schemas/media/i2c/sony,imx890.yaml#
$schema: http://devicetree.org/meta-schemas/core.yaml#

title: Sony IMX890 Image Sensor

description:
  Sony IMX890 is a 50MP image sensor. The sensor is controlled over a
  serial camera control bus protocol, the widest output image frame size
  is 8192x6144, data output format is RAW10 transferred over a 3-trio
  MIPI C-PHY interface.

maintainers:
  - Shandorman <98683030+jiganomegsdfdf@users.noreply.github.com>

allOf:
  - $ref: /schemas/media/video-interface-devices.yaml#

properties:
  compatible:
    const: sony,imx890

  reg:
    maxItems: 1

  clocks:
    description: MCLK supply clock.
    maxItems: 1

  reset-gpios:
    description: Active low GPIO connected to XCLR pad of the sensor.
    maxItems: 1

  avdd-supply:
    description: Analogue voltage supply, 2.8 volts.

  dvdd-supply:
    description: Digital core voltage supply, 1.1 volts.

  dovdd-supply:
    description: Digital I/O voltage supply, 1.8 volts.

  vaux1-supply:
    description:
      Module supply of 1.8 volts that the stock power sequence enables
      along with the sensor supplies.

  vaux2-supply:
    description:
      Module supply of 2.8 volts that the stock power sequence enables
      along with the sensor supplies.

  port:
    $ref: /schemas/graph.yaml#/$defs/port-base
    additionalProperties: false

    properties:
      endpoint:
        $ref: /schemas/media/video-interfaces.yaml#
        unevaluatedProperties: false

        properties:
          bus-type:
            const: 1

          data-lanes:
            items:
              - const: 0
              - const: 1
              - const: 2

        required:
          - bus-type
          - data-lanes
          - link-frequencies

required:
  - compatible
  - reg
  - port

unevaluatedProperties: false

examples:
  - |
      #include <dt-bindings/gpio/gpio.h>
      #include <dt-bindings/media/video-interfaces.h>

      i2c {
          #address-cells = <1>;
          #size-cells = <0>;

          camera@1a {
              compatible = "sony,imx890";
              reg = <0x1a>;
              clocks = <&camera_mclk 0>;
              assigned-clocks = <&camera_mclk 0>;
              assigned-clock-rates = <19200000>;
              reset-gpios = <&gpio1 10 GPIO_ACTIVE_LOW>;
              avdd-supply = <&vreg_2p8>;
              dvdd-supply = <&vreg_1p1>;
              dovdd-supply = <&vreg_1p8>;

              port {
                  endpoint {
                      bus-type = <MEDIA_BUS_TYPE_CSI2_CPHY>;
                      data-lanes = <0 1 2>;
                      link-frequencies = /bits/ 64 <708000000>;
                      remote-endpoint = <&mipi_csi2_ep>;
                  };
              };
          };
      };
...
```

## Documentation/devicetree/bindings/misc/goodix,gum5228.yaml
```yaml
# SPDX-License-Identifier: (GPL-2.0-only OR BSD-2-Clause)
%YAML 1.2
---
$id: http://devicetree.org/schemas/misc/goodix,gum5228.yaml#
$schema: http://devicetree.org/meta-schemas/core.yaml#

title: Goodix GUM5228 ultrasonic fingerprint platform control

maintainers:
  - Doctor Logix <doctor.logix@gmail.com>

description: |
  Power, reset and interrupt wiring for a Goodix ultrasonic fingerprint
  sensor. The secure world owns the SPI bus; biometric commands go to
  the signed trusted application through the TEE subsystem.

properties:
  compatible:
    const: goodix,gum5228

  reset-gpios:
    maxItems: 1
    description: Active-low sensor reset.

  interrupt-gpios:
    maxItems: 1
    description: Active-high sensor interrupt, sampled on the rising edge.

  vdd-supply:
    description: Sensor analog supply.

  pinctrl-0: true
  pinctrl-names:
    const: default

required:
  - compatible
  - reset-gpios
  - interrupt-gpios
  - vdd-supply

additionalProperties: false
```

## Documentation/devicetree/bindings/misc/jiiov,jv0307.yaml
```yaml
# SPDX-License-Identifier: (GPL-2.0-only OR BSD-2-Clause)
%YAML 1.2
---
$id: http://devicetree.org/schemas/misc/jiiov,jv0307.yaml#
$schema: http://devicetree.org/meta-schemas/core.yaml#

title: JIIOV JV0307 optical fingerprint platform control

maintainers:
  - Doctor Logix <doctor.logix@gmail.com>

description: |
  Power, reset and interrupt wiring for a JIIOV under-display optical
  fingerprint sensor. The secure world owns the SPI bus; biometric
  commands go to the signed trusted application through the TEE
  subsystem.

properties:
  compatible:
    const: jiiov,jv0307

  reset-gpios:
    maxItems: 1
    description: Active-low sensor reset.

  interrupt-gpios:
    maxItems: 1
    description: Active-high sensor interrupt, sampled on the rising edge.

  vdd-supply:
    description: Sensor supply.

  pinctrl-0: true
  pinctrl-names:
    const: default

required:
  - compatible
  - reset-gpios
  - interrupt-gpios
  - vdd-supply

additionalProperties: false
```

## Documentation/devicetree/bindings/misc/oneplus,aston-fingerprint.yaml
```yaml
# SPDX-License-Identifier: (GPL-2.0-only OR BSD-2-Clause)
%YAML 1.2
---
$id: http://devicetree.org/schemas/misc/oneplus,aston-fingerprint.yaml#
$schema: http://devicetree.org/meta-schemas/core.yaml#

title: OnePlus Aston UFF optical fingerprint platform control

maintainers:
  - Doctor Logix <doctor.logix@gmail.com>

description: |
  Power, reset and interrupt wiring for the Aston secure optical fingerprint
  sensor. The secure world owns the sensor bus; no SPI controller or biometric
  data is exposed by this platform device.

properties:
  compatible:
    const: oneplus,aston-fingerprint
  reset-gpios:
    maxItems: 1
    description: Active-low sensor reset.
  interrupt-gpios:
    maxItems: 1
    description: Active-high sensor interrupt, sampled on the rising edge.
  vdd-supply:
    description: Sensor analog supply at 3.01 V.

required:
  - compatible
  - reset-gpios
  - interrupt-gpios
  - vdd-supply

additionalProperties: false
```

## Documentation/devicetree/bindings/pinctrl/mediatek,mt6897-pinctrl.yaml
```yaml
# SPDX-License-Identifier: (GPL-2.0-only OR BSD-2-Clause)
%YAML 1.2
---
$id: http://devicetree.org/schemas/pinctrl/mediatek,mt6897-pinctrl.yaml#
$schema: http://devicetree.org/meta-schemas/core.yaml#

title: MediaTek MT6897 Pin Controller

maintainers:
  - Doctor Logix <doctor.logix@gmail.com>

description:
  The MediaTek's MT6897 Pin controller is used to control SoC pins.

properties:
  compatible:
    const: mediatek,mt6897-pinctrl

  reg:
    items:
      - description: gpio base
      - description: rt group IO
      - description: rm group IO
      - description: bl group IO
      - description: bm group IO
      - description: br group IO
      - description: lb group IO
      - description: lt group IO
      - description: tm group IO
      - description: tl group IO
      - description: eint east group IO
      - description: eint south group IO
      - description: eint west group IO
      - description: eint north group IO
      - description: eint center group IO

  reg-names:
    items:
      - const: base
      - const: rt
      - const: rm
      - const: bl
      - const: bm
      - const: br
      - const: lb
      - const: lt
      - const: tm
      - const: tl
      - const: eint0
      - const: eint1
      - const: eint2
      - const: eint3
      - const: eint4

  interrupts:
    maxItems: 1

  interrupt-controller: true

  '#interrupt-cells':
    const: 2

  gpio-controller: true

  '#gpio-cells':
    const: 2

  gpio-ranges:
    maxItems: 1

  gpio-line-names: true

# PIN CONFIGURATION NODES
patternProperties:
  '-pins$':
    type: object
    additionalProperties: false

    patternProperties:
      '^pins':
        type: object
        $ref: /schemas/pinctrl/pincfg-node.yaml
        additionalProperties: false
        description:
          A pinctrl node should contain at least one subnodes representing the
          pinctrl groups available on the machine. Each subnode will list the
          pins it needs, and how they should be configured, with regard to muxer
          configuration, pullups, drive strength, input enable/disable and input
          schmitt.

        properties:
          pinmux:
            description:
              Integer array, represents gpio pin number and mux setting.
              Supported pin number and mux varies for different SoCs, and are
              defined as macros in arch/arm64/boot/dts/mediatek/mt6897-pinfunc.h
              for this SoC.

          drive-strength:
            enum: [2, 4, 6, 8, 10, 12, 14, 16]

          bias-pull-down:
            oneOf:
              - type: boolean
                description: normal pull down.
              - enum: [100, 101, 102, 103]
                description: PUPD/R1/R0 pull down type. See MTK_PUPD_SET_R1R0_
                  defines in dt-bindings/pinctrl/mt65xx.h.
              - enum: [200, 201, 202, 203]
                description: RSEL pull down type. See MTK_PULL_SET_RSEL_ defines
                  in dt-bindings/pinctrl/mt65xx.h.

          bias-pull-up:
            oneOf:
              - type: boolean
                description: normal pull up.
              - enum: [100, 101, 102, 103]
                description: PUPD/R1/R0 pull up type. See MTK_PUPD_SET_R1R0_
                  defines in dt-bindings/pinctrl/mt65xx.h.
              - enum: [200, 201, 202, 203]
                description: RSEL pull up type. See MTK_PULL_SET_RSEL_ defines
                  in dt-bindings/pinctrl/mt65xx.h.

          bias-disable: true

          output-high: true

          output-low: true

          input-enable: true

          input-disable: true

          input-schmitt-enable: true

          input-schmitt-disable: true

        required:
          - pinmux

required:
  - compatible
  - reg
  - interrupts
  - interrupt-controller
  - '#interrupt-cells'
  - gpio-controller
  - '#gpio-cells'
  - gpio-ranges

additionalProperties: false

examples:
  - |
    #include <dt-bindings/pinctrl/mt65xx.h>
    #include <dt-bindings/interrupt-controller/arm-gic.h>
    #define PINMUX_GPIO147__FUNC_SCL5 (MTK_PIN_NO(147) | 1)
    #define PINMUX_GPIO148__FUNC_SDA5 (MTK_PIN_NO(148) | 1)

    pio: pinctrl@10005000 {
        compatible = "mediatek,mt6897-pinctrl";
        reg = <0x10005000 0x1000>,
              <0x11b20000 0x1000>,
              <0x11c00000 0x1000>,
              <0x11d30000 0x1000>,
              <0x11d40000 0x1000>,
              <0x11d50000 0x1000>,
              <0x11ea0000 0x1000>,
              <0x11eb0000 0x1000>,
              <0x11f20000 0x1000>,
              <0x11f30000 0x1000>,
              <0x11ce0000 0x1000>,
              <0x11de0000 0x1000>,
              <0x11e90000 0x1000>,
              <0x11fe0000 0x1000>,
              <0x1c01e000 0x1000>;
        reg-names = "base", "rt", "rm", "bl", "bm", "br", "lb", "lt",
                    "tm", "tl", "eint0", "eint1", "eint2", "eint3", "eint4";
        gpio-controller;
        #gpio-cells = <2>;
        gpio-ranges = <&pio 0 0 232>;
        interrupt-controller;
        interrupts = <GIC_SPI 309 IRQ_TYPE_LEVEL_HIGH 0>;
        #interrupt-cells = <2>;

        i2c5-pins {
            pins {
                pinmux = <PINMUX_GPIO147__FUNC_SCL5>,
                         <PINMUX_GPIO148__FUNC_SDA5>;
                bias-disable;
            };
        };
    };
```
