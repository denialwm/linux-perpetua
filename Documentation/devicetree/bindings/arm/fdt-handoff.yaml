## Documentation/devicetree/bindings/arm/fdt-handoff.yaml
```yaml
# SPDX-License-Identifier: (GPL-2.0-only OR BSD-2-Clause)
%YAML 1.2
---
$id: http://devicetree.org/schemas/arm/fdt-handoff.yaml#
$schema: http://devicetree.org/meta-schemas/core.yaml#

title: Device tree handoff from vendor bootloaders

maintainers:
  - Doctor Logix <doctor.logix@gmail.com>

description: |
  The Android bootloaders of many phones and tablets only boot a vendor
  device tree taken from their own images. They fill that tree with what only
  they know, such as the memory map, the firmware reservations, the initramfs
  and the board addresses, but the rest of it describes the vendor kernel.

  A device tree built into the kernel image describes the bootloader tree it
  replaces with a /chosen/fdt-handoff node. When the bootloader passes that
  tree, an arm64 kernel with ARM64_FDT_HANDOFF boots the built-in tree
  instead, after:

  - replacing its memory with the bootloader's usable memory, without the
    no-map regions of the bootloader's reserved-memory;
  - adding the other fixed reservations of the bootloader's tree to the
    memory reservation map, instead of importing its reserved-memory nodes,
    which belong to vendor drivers;
  - optionally, using the initramfs that the bootloader loaded;
  - carrying over the board addresses that the child nodes describe.

  The boot arguments are those of the built-in tree's own /chosen, and the
  kernel adds an empty /chosen/linux,fdt-handoff property to it. Any other
  bootloader tree boots as usual.

properties:
  $nodename:
    const: fdt-handoff

  stock-compatible:
    $ref: /schemas/types.yaml#/definitions/string-array
    description:
      The root node of the bootloader's tree is compatible with one of these.

  stock-model:
    $ref: /schemas/types.yaml#/definitions/string-array
    description:
      The root model of the bootloader's tree is one of these.

  stock-bootargs:
    $ref: /schemas/types.yaml#/definitions/string-array
    description:
      The /chosen/bootargs of the bootloader's tree have one of these as a
      word, separated by spaces or newlines.

  keep-initrd:
    type: boolean
    description:
      Boot the initramfs that the bootloader loaded, as its
      /chosen/linux,initrd-start and linux,initrd-end describe it.

patternProperties:
  "-address$":
    type: object
    additionalProperties: false
    description:
      A MAC or Bluetooth address that the bootloader passes as text, for
      example as KEY=12:34:56:78:9a:bc in its boot arguments. When the address
      is missing or malformed, the target keeps its own.

    properties:
      stock-path:
        $ref: /schemas/types.yaml#/definitions/string
        description: The node of the bootloader's tree that has the text.

      stock-property:
        $ref: /schemas/types.yaml#/definitions/string
        description: The property that has the text, for example bootargs.

      stock-key:
        $ref: /schemas/types.yaml#/definitions/string
        description:
          The address follows the first word that starts with this key, as
          six hexadecimal bytes separated by colons.

      target:
        $ref: /schemas/types.yaml#/definitions/phandle
        description: The node of this tree that receives the address.

      target-property:
        $ref: /schemas/types.yaml#/definitions/string
        description: The property that receives the six bytes.

      reverse-bytes:
        type: boolean
        description:
          Store the bytes in reverse order, for little-endian properties such
          as local-bd-address.

    required:
      - stock-path
      - stock-property
      - stock-key
      - target
      - target-property

required:
  - stock-compatible

additionalProperties: false

examples:
  - |
    chosen {
        bootargs = "rdinit=/init panic=10";

        fdt-handoff {
            stock-compatible = "qcom,kera";
            stock-model = "roadstr";
            keep-initrd;

            wifi-address {
                stock-path = "/chosen";
                stock-property = "bootargs";
                stock-key = "wifimacaddr=";
                target = <&wlan>;
                target-property = "local-mac-address";
            };
        };
    };

    wlan: wifi {
        local-mac-address = [00 00 00 00 00 00];
    };
...
```

## Documentation/devicetree/bindings/display/mediatek/mediatek,mt6897-dpu.yaml
```yaml
# SPDX-License-Identifier: (GPL-2.0-only OR BSD-2-Clause)
%YAML 1.2
---
$id: http://devicetree.org/schemas/display/mediatek/mediatek,mt6897-dpu.yaml#
$schema: http://devicetree.org/meta-schemas/core.yaml#

title: MediaTek MT6897 display processor

maintainers:
  - Doctor Logix <doctor.logix@gmail.com>

description:
  The display pipeline of the MediaTek MT6897 (Dimensity 8300) SoC. Each
  frame is split into two vertical stripes, one per pipe; each pipe has
  its own overlay engine (OVL) in its own OVL subsystem, and its own DSC
  encoder and DSI link in its own display subsystem. The processor owns
  each subsystem whole, with its routing, its mutexes and its engines.

properties:
  compatible:
    const: mediatek,mt6897-dpu

  reg:
    items:
      - description: display subsystem of the first pipe, with the master
          DSI link
      - description: display subsystem of the second pipe
      - description: OVL subsystem of the first pipe
      - description: OVL subsystem of the second pipe

  reg-names:
    items:
      - const: dispsys0
      - const: dispsys1
      - const: ovlsys0
      - const: ovlsys1

  interrupts:
    items:
      - description: overlay engine of the first pipe
      - description: overlay engine of the second pipe

  interrupt-names:
    items:
      - const: ovl0
      - const: ovl1

  clocks:
    items:
      - description: high-speed clock of the first DSI link, from its PHY
      - description: high-speed clock of the second DSI link, from its PHY

  clock-names:
    items:
      - const: dsi0-hs
      - const: dsi1-hs

  phys:
    items:
      - description: MIPI D-PHY of the first DSI link
      - description: MIPI D-PHY of the second DSI link

  phy-names:
    items:
      - const: dsi0
      - const: dsi1

  "#address-cells":
    const: 1

  "#size-cells":
    const: 0

patternProperties:
  "^panel@[0-3]$":
    type: object
    description:
      The panel on the DSI links. Commands go out on both links at once.

required:
  - compatible
  - reg
  - reg-names
  - interrupts
  - interrupt-names
  - clocks
  - clock-names
  - phys
  - phy-names

additionalProperties: false

examples:
  - |
    #include <dt-bindings/interrupt-controller/arm-gic.h>
    #include <dt-bindings/interrupt-controller/irq.h>

    display-controller@14000000 {
        compatible = "mediatek,mt6897-dpu";
        reg = <0x14000000 0xe000>, <0x14200000 0xe000>,
              <0x14400000 0x3000>, <0x14600000 0x3000>;
        reg-names = "dispsys0", "dispsys1", "ovlsys0", "ovlsys1";
        interrupts = <GIC_SPI 387 IRQ_TYPE_LEVEL_HIGH>,
                     <GIC_SPI 431 IRQ_TYPE_LEVEL_HIGH>;
        interrupt-names = "ovl0", "ovl1";
        clocks = <&mipi_tx0>, <&mipi_tx1>;
        clock-names = "dsi0-hs", "dsi1-hs";
        phys = <&mipi_tx0>, <&mipi_tx1>;
        phy-names = "dsi0", "dsi1";
        #address-cells = <1>;
        #size-cells = <0>;

        panel@0 {
            compatible = "lenovo,tb373fu-tianma-nt36532", "novatek,nt36532";
            reg = <0>;
            reset-gpios = <&pio 41 1>;
            vddi-supply = <&panel_vddi>;
            avdd-supply = <&panel_avdd>;
            avee-supply = <&panel_avee>;
        };
    };
```

## Documentation/devicetree/bindings/display/panel/novatek,nt36532.yaml
```yaml
# SPDX-License-Identifier: GPL-2.0-only OR BSD-2-Clause
%YAML 1.2
---
$id: http://devicetree.org/schemas/display/panel/novatek,nt36532.yaml#
$schema: http://devicetree.org/meta-schemas/core.yaml#

title: Novatek NT36532 based DSI display panels

maintainers:
  - Doctor Logix <doctor.logix@gmail.com>

description:
  The Novatek NT36532 is a display driver IC for tablet panels, fed by two
  DSI links, one per vertical stripe of the frame. The panel node sits on
  the host that drives both links.

allOf:
  - $ref: panel-common.yaml#

properties:
  compatible:
    items:
      - enum:
          - lenovo,tb373fu-tianma-nt36532
      - const: novatek,nt36532

  reg:
    maxItems: 1
    description: DSI virtual channel

  vddi-supply: true
  avdd-supply: true
  avee-supply: true
  reset-gpios: true
  backlight: true

required:
  - compatible
  - reg
  - vddi-supply
  - avdd-supply
  - avee-supply
  - reset-gpios

additionalProperties: false

examples:
  - |
    #include <dt-bindings/gpio/gpio.h>

    dsi {
        #address-cells = <1>;
        #size-cells = <0>;

        panel@0 {
            compatible = "lenovo,tb373fu-tianma-nt36532", "novatek,nt36532";
            reg = <0>;
            reset-gpios = <&pio 41 GPIO_ACTIVE_LOW>;
            vddi-supply = <&panel_vddi>;
            avdd-supply = <&panel_avdd>;
            avee-supply = <&panel_avee>;
            backlight = <&backlight>;
        };
    };
...
```

## Documentation/devicetree/bindings/display/panel/novatek,nt37706.yaml
```yaml
# SPDX-License-Identifier: GPL-2.0-only OR BSD-2-Clause
%YAML 1.2
---
$id: http://devicetree.org/schemas/display/panel/novatek,nt37706.yaml#
$schema: http://devicetree.org/meta-schemas/core.yaml#

title: Novatek NT37706 based AMOLED DSI panels

maintainers:
  - Doctor Logix <doctor.logix@gmail.com>

description:
  The Novatek NT37706 is a display driver IC for AMOLED panels. The CSOT
  6.67" 1220x2712 panel of the Motorola Edge 70 runs it in video mode with
  DSC at 10 bits per component; v3 is the revision of its initialization
  sequence.

allOf:
  - $ref: panel-common.yaml#

properties:
  compatible:
    items:
      - enum:
          - csot,nt37706-v3
      - const: novatek,nt37706

  reg:
    maxItems: 1
    description: DSI virtual channel

  vci-supply: true
  vdd-supply: true
  vddio-supply: true
  port: true
  reset-gpios: true

required:
  - compatible
  - reg
  - vci-supply
  - vdd-supply
  - vddio-supply
  - port
  - reset-gpios

additionalProperties: false

examples:
  - |
    #include <dt-bindings/gpio/gpio.h>

    dsi {
        #address-cells = <1>;
        #size-cells = <0>;

        panel@0 {
            compatible = "csot,nt37706-v3", "novatek,nt37706";
            reg = <0>;

            vci-supply = <&vreg_l19b>;
            vdd-supply = <&vreg_l1g>;
            vddio-supply = <&vreg_l8b>;

            reset-gpios = <&tlmm 12 GPIO_ACTIVE_LOW>;

            port {
                endpoint {
                    remote-endpoint = <&mdss_dsi0_out>;
                };
            };
        };
    };
...
```

## Documentation/devicetree/bindings/display/panel/oneplus,aston-boe-aa551.yaml
```yaml
# SPDX-License-Identifier: GPL-2.0-only OR BSD-2-Clause
%YAML 1.2
---
$id: http://devicetree.org/schemas/display/panel/oneplus,aston-boe-aa551.yaml#
$schema: http://devicetree.org/meta-schemas/core.yaml#

title: BOE AA551 AMOLED panel of the OnePlus 12R and Ace 3

maintainers:
  - Doctor Logix <doctor.logix@gmail.com>

description: |
  The 6.78" 1264x2780 AMOLED panel of the OnePlus 12R and OnePlus Ace 3
  (aston), made by BOE and named AA551-P-3-A0004 in the vendor sources. It
  is driven over four DSI lanes in command mode, with DSC 1.2 at 10 bits
  per component, and its brightness is set through DCS.

  On these phones the DSI lanes pass through a Pixelworks Iris7P display
  processor before they reach the panel. The Iris7P is kept in its analog
  bypass, in which it passes the link through unchanged. Powering it,
  releasing its reset and switching it to the bypass are part of the
  panel's power-on sequence, so its control lines are described here.

allOf:
  - $ref: panel-common.yaml#

properties:
  compatible:
    const: oneplus,aston-boe-aa551

  reg:
    maxItems: 1
    description: DSI virtual channel

  vddio-supply:
    description: 1.8 V I/O supply, which also feeds the Iris7P 1.8 V rail

  vci-supply:
    description: 3.0 V analog supply

  reset-gpios: true

  iris-vdd0p9-gpios:
    maxItems: 1
    description: Enable of the Iris7P 0.9 V core supply

  iris-reset-gpios:
    maxItems: 1
    description: Iris7P reset

  iris-wakeup-gpios:
    maxItems: 1
    description:
      Iris7P wakeup line. The host also sends the Iris7P one-wire commands
      on it, so it must be a GPIO that can be set without sleeping.

  iris-abyp-ready-gpios:
    maxItems: 1
    description: Iris7P output that signals that its analog bypass is active

  port: true

required:
  - compatible
  - reg
  - vddio-supply
  - vci-supply
  - reset-gpios
  - iris-vdd0p9-gpios
  - iris-reset-gpios
  - iris-wakeup-gpios
  - iris-abyp-ready-gpios
  - port

additionalProperties: false

examples:
  - |
    #include <dt-bindings/gpio/gpio.h>

    dsi {
        #address-cells = <1>;
        #size-cells = <0>;

        panel@0 {
            compatible = "oneplus,aston-boe-aa551";
            reg = <0>;

            vddio-supply = <&vreg_l12b_1p8>;
            vci-supply = <&vreg_l13b_3p0>;

            reset-gpios = <&tlmm 133 GPIO_ACTIVE_LOW>;

            iris-vdd0p9-gpios = <&tlmm 105 GPIO_ACTIVE_HIGH>;
            iris-reset-gpios = <&tlmm 109 GPIO_ACTIVE_LOW>;
            iris-wakeup-gpios = <&tlmm 129 GPIO_ACTIVE_HIGH>;
            iris-abyp-ready-gpios = <&tlmm 181 GPIO_ACTIVE_HIGH>;

            port {
                endpoint {
                    remote-endpoint = <&mdss_dsi0_out>;
                };
            };
        };
    };
...
```

## Documentation/devicetree/bindings/display/panel/raydium,rm692h5.yaml
```yaml
# SPDX-License-Identifier: GPL-2.0-only OR BSD-2-Clause
%YAML 1.2
---
$id: http://devicetree.org/schemas/display/panel/raydium,rm692h5.yaml#
$schema: http://devicetree.org/meta-schemas/core.yaml#

title: Raydium RM692H5 based DSI display panels

maintainers:
  - Reixo <125610085+Reixo0@users.noreply.github.com>

description:
  The Raydium RM692H5 is a DSI panel IC used to control AMOLED panels, such
  as the 6.8" 1216x2688 DSC command mode panel in the Nubia RedMagic 11 Pro.

allOf:
  - $ref: panel-common.yaml#

properties:
  compatible:
    items:
      - const: nubia,nx809j-rm692h5
      - const: raydium,rm692h5

  reg:
    maxItems: 1

  vddio-supply:
    description: I/O voltage rail

  vdd-supply:
    description: Digital voltage rail

  vci-supply:
    description: Analog voltage rail

required:
  - compatible
  - reg
  - reset-gpios
  - vddio-supply
  - vdd-supply
  - vci-supply
  - port

unevaluatedProperties: false

examples:
  - |
    #include <dt-bindings/gpio/gpio.h>

    dsi {
        #address-cells = <1>;
        #size-cells = <0>;

        panel@0 {
            compatible = "nubia,nx809j-rm692h5", "raydium,rm692h5";
            reg = <0>;

            reset-gpios = <&tlmm 98 GPIO_ACTIVE_LOW>;
            vddio-supply = <&vreg_l12b_1p8>;
            vdd-supply = <&vreg_l11b_1p0>;
            vci-supply = <&vreg_l13b_3p0>;

            port {
                panel_in_0: endpoint {
                    remote-endpoint = <&dsi0_out>;
                };
            };
        };
    };

...
```
