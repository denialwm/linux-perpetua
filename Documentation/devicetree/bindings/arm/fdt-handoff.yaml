## Documentation/devicetree/bindings/display/panel/xiaomi,pudding-p3.yaml
```yaml
# SPDX-License-Identifier: GPL-2.0-only OR BSD-2-Clause
%YAML 1.2
---
$id: http://devicetree.org/schemas/display/panel/xiaomi,pudding-p3.yaml#
$schema: http://devicetree.org/meta-schemas/core.yaml#

title: Xiaomi 17 P3 42 02 0a AMOLED DSI panel

maintainers:
  - Doctor Logix <doctor.logix@gmail.com>

description:
  The 6.3" 1220x2656 AMOLED panel of the Xiaomi 17 (pudding), which Xiaomi
  names P3 42 02 0a. It runs a Novatek controller in video mode with DSC at
  10 bits per component.

allOf:
  - $ref: panel-common.yaml#

properties:
  compatible:
    const: xiaomi,pudding-p3-42-02-0a

  reg:
    maxItems: 1
    description: DSI virtual channel

  vci-supply: true
  vddd-supply: true
  vddio-supply: true
  port: true
  reset-gpios: true

  pmic-reset-gpios:
    maxItems: 1
    description: Reset of the panel's OLED power chip

required:
  - compatible
  - reg
  - vci-supply
  - vddd-supply
  - vddio-supply
  - port
  - reset-gpios
  - pmic-reset-gpios

additionalProperties: false

examples:
  - |
    #include <dt-bindings/gpio/gpio.h>

    dsi {
        #address-cells = <1>;
        #size-cells = <0>;

        panel@0 {
            compatible = "xiaomi,pudding-p3-42-02-0a";
            reg = <0>;

            vci-supply = <&vreg_l14b>;
            vddd-supply = <&vreg_panel_vddd>;
            vddio-supply = <&vreg_l12b>;

            reset-gpios = <&tlmm 98 GPIO_ACTIVE_LOW>;
            pmic-reset-gpios = <&tlmm 171 GPIO_ACTIVE_LOW>;

            port {
                endpoint {
                    remote-endpoint = <&mdss_dsi0_out>;
                };
            };
        };
    };
...
```

## Documentation/devicetree/bindings/hwmon/awinic,awp1921.yaml
```yaml
# SPDX-License-Identifier: (GPL-2.0-only OR BSD-2-Clause)
%YAML 1.2
---
$id: http://devicetree.org/schemas/hwmon/awinic,awp1921.yaml#
$schema: http://devicetree.org/meta-schemas/core.yaml#

title: Awinic AWP1921 piezoelectric micropump driver

maintainers:
  - Doctor Logix <doctor.logix@gmail.com>

description:
  The AWP1921 drives a piezoelectric micropump, such as the one of the
  liquid cooling loop in the Nubia RedMagic 11 Pro. It is controlled over
  I2C and serves as a cooling device with four levels, from off to high.

properties:
  compatible:
    const: awinic,awp1921

  reg:
    maxItems: 1

  enable-gpios:
    maxItems: 1
    description: GPIO connected to the enable input of the chip.

  "#cooling-cells":
    const: 2

required:
  - compatible
  - reg
  - enable-gpios

additionalProperties: false

examples:
  - |
    #include <dt-bindings/gpio/gpio.h>

    i2c {
        #address-cells = <1>;
        #size-cells = <0>;

        micropump@44 {
            compatible = "awinic,awp1921";
            reg = <0x44>;
            enable-gpios = <&pmic_gpios 1 GPIO_ACTIVE_HIGH>;
            #cooling-cells = <2>;
        };
    };
...
```

## Documentation/devicetree/bindings/input/touchscreen/syna,s3910.yaml
```yaml
# SPDX-License-Identifier: (GPL-2.0-only OR BSD-2-Clause)
%YAML 1.2
---
$id: http://devicetree.org/schemas/input/touchscreen/syna,s3910.yaml#
$schema: http://devicetree.org/meta-schemas/core.yaml#

title: Synaptics S3910 TouchComm SPI touchscreen controller

maintainers:
  - Doctor Logix <doctor.logix@gmail.com>

description:
  The Synaptics S3910 is a touchscreen controller that speaks the Synaptics
  TouchComm protocol over SPI. It runs its application firmware from its own
  flash.

allOf:
  - $ref: touchscreen.yaml#
  - $ref: /schemas/spi/spi-peripheral-props.yaml#

properties:
  compatible:
    const: syna,s3910

  reg:
    maxItems: 1

  interrupts:
    maxItems: 1

  panel:
    maxItems: 1
    description: Display panel followed for gesture-sleep entry and exit.

  wakeup-source: true

  reset-gpios:
    maxItems: 1
    description: GPIO connected to the active-low reset input.

  vdd-supply:
    description: Digital and I/O supply (1.8 V).

  avdd-supply:
    description: Analog supply.

  syna,report-rate:
    $ref: /schemas/types.yaml#/definitions/uint32
    maximum: 0xffff
    description:
      Touch report rate applied whenever the panel turns on, as the firmware's
      own rate code (dynamic configuration 0xe6). Absent or 0 keeps the rate
      the firmware starts with.

required:
  - compatible
  - reg
  - interrupts
  - reset-gpios
  - vdd-supply
  - avdd-supply

unevaluatedProperties: false

examples:
  - |
    #include <dt-bindings/gpio/gpio.h>
    #include <dt-bindings/interrupt-controller/irq.h>

    spi {
        #address-cells = <1>;
        #size-cells = <0>;

        touchscreen@0 {
            compatible = "syna,s3910";
            reg = <0>;
            spi-max-frequency = <19000000>;
            interrupt-parent = <&tlmm>;
            interrupts = <25 IRQ_TYPE_LEVEL_LOW>;
            reset-gpios = <&tlmm 24 GPIO_ACTIVE_LOW>;
            vdd-supply = <&vreg_l4b_1p8>;
            avdd-supply = <&ts_avdd>;
        };
    };
```

## Documentation/devicetree/bindings/leds/sgmicro,sgm37604a.yaml
```yaml
# SPDX-License-Identifier: (GPL-2.0-only OR BSD-2-Clause)
%YAML 1.2
---
$id: http://devicetree.org/schemas/leds/sgmicro,sgm37604a.yaml#
$schema: http://devicetree.org/meta-schemas/core.yaml#

title: SG Micro SGM37604A four-string white LED driver

maintainers:
  - Doctor Logix <doctor.logix@gmail.com>

description:
  The SGM37604A drives up to four white LED strings, usually a display
  backlight, from a boost converter. A 12-bit code set over I2C controls
  the current of all strings together.

properties:
  compatible:
    const: sgmicro,sgm37604a

  reg:
    maxItems: 1

  led:
    type: object
    $ref: common.yaml#
    unevaluatedProperties: false

    properties:
      led-sources:
        description: The strings wired to LEDs, numbered 0 to 3. All four
          when absent.
        minItems: 1
        maxItems: 4
        items:
          enum: [0, 1, 2, 3]

required:
  - compatible
  - reg
  - led

additionalProperties: false

examples:
  - |
    #include <dt-bindings/leds/common.h>

    i2c {
        #address-cells = <1>;
        #size-cells = <0>;

        led-controller@36 {
            compatible = "sgmicro,sgm37604a";
            reg = <0x36>;

            led {
                color = <LED_COLOR_ID_WHITE>;
                function = LED_FUNCTION_BACKLIGHT;
                led-sources = <0 1 2 3>;
            };
        };
    };
```

## Documentation/devicetree/bindings/media/i2c/dongwoon,dw9785.yaml
```yaml
# SPDX-License-Identifier: (GPL-2.0-only OR BSD-2-Clause)
%YAML 1.2
---
$id: http://devicetree.org/schemas/media/i2c/dongwoon,dw9785.yaml#
$schema: http://devicetree.org/meta-schemas/core.yaml#

title: Dongwoon Anatech DW9785 Lens Controller

maintainers:
  - Doctor Logix <doctor.logix@gmail.com>

description:
  The Dongwoon DW9785 drives the focus and the optical image stabilisation
  of a camera module from its own DSP, over a 16-bit register I2C interface.

properties:
  compatible:
    const: dongwoon,dw9785

  reg:
    maxItems: 1

  vio-supply:
    description: I/O supply.

  vaf-supply:
    description: Actuator supply.

  oisvdd-supply:
    description: Stabiliser supply, switched on after the other two.

required:
  - compatible
  - reg
  - vio-supply
  - vaf-supply
  - oisvdd-supply

additionalProperties: false

examples:
  - |
    i2c {
        #address-cells = <1>;
        #size-cells = <0>;

        lens@24 {
            compatible = "dongwoon,dw9785";
            reg = <0x24>;

            vio-supply = <&vreg_cam_io>;
            vaf-supply = <&vreg_cam_af>;
            oisvdd-supply = <&vreg_cam_ois>;
        };
    };
...
```

## Documentation/devicetree/bindings/media/i2c/ovti,ov02f10.yaml
```yaml
# SPDX-License-Identifier: (GPL-2.0-only OR BSD-2-Clause)
%YAML 1.2
---
$id: http://devicetree.org/schemas/media/i2c/ovti,ov02f10.yaml#
$schema: http://devicetree.org/meta-schemas/core.yaml#

title: OmniVision OV02F10 Image Sensor

description:
  OmniVision OV02F10 is a 2MP image sensor. The sensor is controlled over a
  serial camera control bus protocol, the widest output image frame size
  is 1600x1200, data output format is RAW10 transferred over a 1-lane
  MIPI D-PHY interface.

maintainers:
  - Doctor Logix <doctor.logix@gmail.com>

allOf:
  - $ref: /schemas/media/video-interface-devices.yaml#

properties:
  compatible:
    const: ovti,ov02f10

  reg:
    maxItems: 1

  clocks:
    description: MCLK supply clock.
    maxItems: 1

  reset-gpios:
    description: Active low GPIO connected to the XSHUTDOWN pad of the sensor.
    maxItems: 1

  avdd-supply:
    description: Analogue voltage supply.

  dovdd-supply:
    description: Digital I/O voltage supply.

  port:
    $ref: /schemas/graph.yaml#/$defs/port-base
    additionalProperties: false

    properties:
      endpoint:
        $ref: /schemas/media/video-interfaces.yaml#
        unevaluatedProperties: false

        properties:
          data-lanes:
            items:
              - const: 1

        required:
          - data-lanes
          - link-frequencies

required:
  - compatible
  - reg
  - clocks
  - port

unevaluatedProperties: false

examples:
  - |
      #include <dt-bindings/gpio/gpio.h>

      i2c {
          #address-cells = <1>;
          #size-cells = <0>;

          camera@3d {
              compatible = "ovti,ov02f10";
              reg = <0x3d>;
              clocks = <&camera_mclk 3>;
              assigned-clocks = <&camera_mclk 3>;
              assigned-clock-rates = <19200000>;
              reset-gpios = <&gpio1 105 GPIO_ACTIVE_LOW>;
              avdd-supply = <&vreg_cam_ana>;
              dovdd-supply = <&vreg_cam_io>;

              port {
                  endpoint {
                      data-lanes = <1>;
                      link-frequencies = /bits/ 64 <330000000>;
                      remote-endpoint = <&mipi_csi2_ep>;
                  };
              };
          };
      };
...
```

## Documentation/devicetree/bindings/media/i2c/ovti,ov16a1q.yaml
```yaml
# SPDX-License-Identifier: (GPL-2.0-only OR BSD-2-Clause)
%YAML 1.2
---
$id: http://devicetree.org/schemas/media/i2c/ovti,ov16a1q.yaml#
$schema: http://devicetree.org/meta-schemas/core.yaml#

title: OmniVision OV16A1Q Image Sensor

description:
  OmniVision OV16A1Q is a 16MP image sensor. The sensor is controlled over a
  serial camera control bus protocol, the widest output image frame size
  is 4608x3456, data output format is RAW10 transferred over a 4-lane
  MIPI D-PHY interface.

maintainers:
  - Doctor Logix <doctor.logix@gmail.com>

allOf:
  - $ref: /schemas/media/video-interface-devices.yaml#

properties:
  compatible:
    const: ovti,ov16a1q

  reg:
    maxItems: 1

  clocks:
    description: MCLK supply clock.
    maxItems: 1

  reset-gpios:
    description: Active low GPIO connected to the XSHUTDOWN pad of the sensor.
    maxItems: 1

  avdd-supply:
    description: Analogue voltage supply.

  dvdd-supply:
    description: Digital core voltage supply, 1.2 volts.

  dovdd-supply:
    description: Digital I/O voltage supply.

  port:
    $ref: /schemas/graph.yaml#/$defs/port-base
    additionalProperties: false

    properties:
      endpoint:
        $ref: /schemas/media/video-interfaces.yaml#
        unevaluatedProperties: false

        properties:
          data-lanes:
            items:
              - const: 1
              - const: 2
              - const: 3
              - const: 4

        required:
          - data-lanes
          - link-frequencies

required:
  - compatible
  - reg
  - clocks
  - port

unevaluatedProperties: false

examples:
  - |
      #include <dt-bindings/gpio/gpio.h>

      i2c {
          #address-cells = <1>;
          #size-cells = <0>;

          camera@10 {
              compatible = "ovti,ov16a1q";
              reg = <0x10>;
              clocks = <&camera_mclk 0>;
              assigned-clocks = <&camera_mclk 0>;
              assigned-clock-rates = <19200000>;
              reset-gpios = <&gpio1 7 GPIO_ACTIVE_LOW>;
              avdd-supply = <&vreg_cam_ana>;
              dvdd-supply = <&vreg_1p2>;
              dovdd-supply = <&vreg_cam_io>;

              port {
                  endpoint {
                      data-lanes = <1 2 3 4>;
                      link-frequencies = /bits/ 64 <726400000>;
                      remote-endpoint = <&mipi_csi2_ep>;
                  };
              };
          };
      };
...
```

## Documentation/devicetree/bindings/media/i2c/ovti,ov50d40.yaml
```yaml
# SPDX-License-Identifier: (GPL-2.0-only OR BSD-2-Clause)
%YAML 1.2
---
$id: http://devicetree.org/schemas/media/i2c/ovti,ov50d40.yaml#
$schema: http://devicetree.org/meta-schemas/core.yaml#

title: OmniVision OV50D40 Image Sensor

description:
  OmniVision OV50D40 is a 50MP image sensor. The sensor is controlled over a
  serial camera control bus protocol, the widest output image frame size
  is 8192x6144, data output format is RAW10 transferred over a 4-lane
  MIPI D-PHY interface.

maintainers:
  - Doctor Logix <doctor.logix@gmail.com>

allOf:
  - $ref: /schemas/media/video-interface-devices.yaml#

properties:
  compatible:
    const: ovti,ov50d40

  reg:
    maxItems: 1

  clocks:
    description: MCLK supply clock.
    maxItems: 1

  reset-gpios:
    description: Active low GPIO connected to the XSHUTDOWN pad of the sensor.
    maxItems: 1

  avdd-supply:
    description: Analogue voltage supply.

  dvdd-supply:
    description: Digital core voltage supply, 1.1 volts.

  dovdd-supply:
    description: Digital I/O voltage supply.

  port:
    $ref: /schemas/graph.yaml#/$defs/port-base
    additionalProperties: false

    properties:
      endpoint:
        $ref: /schemas/media/video-interfaces.yaml#
        unevaluatedProperties: false

        properties:
          data-lanes:
            items:
              - const: 1
              - const: 2
              - const: 3
              - const: 4

        required:
          - data-lanes
          - link-frequencies

required:
  - compatible
  - reg
  - clocks
  - port

unevaluatedProperties: false

examples:
  - |
      #include <dt-bindings/gpio/gpio.h>

      i2c {
          #address-cells = <1>;
          #size-cells = <0>;

          camera@22 {
              compatible = "ovti,ov50d40";
              reg = <0x22>;
              clocks = <&camera_mclk 1>;
              assigned-clocks = <&camera_mclk 1>;
              assigned-clock-rates = <24000000>;
              reset-gpios = <&gpio1 15 GPIO_ACTIVE_LOW>;
              avdd-supply = <&vreg_cam_ana>;
              dvdd-supply = <&vreg_1p1>;
              dovdd-supply = <&vreg_cam_io>;

              port {
                  endpoint {
                      data-lanes = <1 2 3 4>;
                      link-frequencies = /bits/ 64 <951000000>;
                      remote-endpoint = <&mipi_csi2_ep>;
                  };
              };
          };
      };
...
```
