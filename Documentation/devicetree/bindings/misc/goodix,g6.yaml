## Documentation/devicetree/bindings/pinctrl/qcom,sm7250-tlmm.yaml
```yaml
# SPDX-License-Identifier: (GPL-2.0-only OR BSD-2-Clause)
%YAML 1.2
---
$id: http://devicetree.org/schemas/pinctrl/qcom,sm7250-tlmm.yaml#
$schema: http://devicetree.org/meta-schemas/core.yaml#

title: Qualcomm SM7250 TLMM pin controller

maintainers:
  - Bjorn Andersson <andersson@kernel.org>

description:
  Top Level Mode Multiplexer pin controller in Qualcomm SM7250 SoC.

allOf:
  - $ref: /schemas/pinctrl/qcom,tlmm-common.yaml#

properties:
  compatible:
    const: qcom,sm7250-tlmm

  reg:
    maxItems: 3

  reg-names:
    items:
      - const: south
      - const: west
      - const: east

  interrupts:
    maxItems: 1

  gpio-reserved-ranges:
    minItems: 1
    maxItems: 73

  gpio-line-names:
    maxItems: 146

patternProperties:
  "-state$":
    oneOf:
      - $ref: "#/$defs/qcom-sm7250-tlmm-state"
      - patternProperties:
          "-pins$":
            $ref: "#/$defs/qcom-sm7250-tlmm-state"
        additionalProperties: false

$defs:
  qcom-sm7250-tlmm-state:
    type: object
    description:
      Pinctrl node's client devices use subnodes for desired pin configuration.
      Client device subnodes use below standard properties.
    $ref: qcom,tlmm-common.yaml#/$defs/qcom-tlmm-state
    unevaluatedProperties: false

    properties:
      pins:
        description:
          List of gpio pins affected by the properties specified in this
          subnode.
        items:
          oneOf:
            - pattern: "^gpio([0-9]|[1-9][0-9]|10[0-9]|1[1-3][0-9]|14[0-5])$"
            - enum: [ sdc1_rclk, sdc1_clk, sdc1_cmd, sdc1_data, sdc2_clk,
                      sdc2_cmd, sdc2_data, ufs_reset ]
        minItems: 1
        maxItems: 36

      function:
        description:
          Specify the alternative function to be configured for the specified
          pins.

        enum: [ gpio, adsp_ext, aoss_cti, atest_char, atest_char0, atest_char1,
                atest_char2, atest_char3, atest_tsens, atest_tsens2, atest_usb1,
                atest_usb10, atest_usb11, atest_usb12, atest_usb13, atest_usb2,
                atest_usb20, atest_usb21, atest_usb22, atest_usb23, aud_ref,
                cam_mclk, cci_async, cci_i2c, cci_timer0, cci_timer1,
                cci_timer2, cci_timer3, cci_timer4, cri_trng, cri_trng0,
                cri_trng1, dbg_out, ddr_bist, ddr_pxi0, ddr_pxi1, ddr_pxi2,
                ddr_pxi3, edp_hot, edp_lcd, gcc_gp1, gcc_gp2, gcc_gp3, gp_pdm0,
                gp_pdm1, gp_pdm2, gps_tx, gps_tx_mird, ibi_i3c, jitter_bist,
                ldo_en, ldo_update, lpass_slimbus, m_voc, mdp_vsync, mdp_vsync0,
                mdp_vsync1, mdp_vsync2, mdp_vsync3, mss_lte, nav_gpio,
                nav_pps_in, nav_pps_out, pa_indicator, phase_flag0, phase_flag1,
                phase_flag10, phase_flag11, phase_flag12, phase_flag13,
                phase_flag14, phase_flag15, phase_flag16, phase_flag17,
                phase_flag18, phase_flag19, phase_flag2, phase_flag20,
                phase_flag21, phase_flag22, phase_flag23, phase_flag24,
                phase_flag25, phase_flag26, phase_flag27, phase_flag28,
                phase_flag29, phase_flag3, phase_flag30, phase_flag31,
                phase_flag4, phase_flag5, phase_flag6, phase_flag7, phase_flag8,
                phase_flag9, pll_bist, pll_bypassnl, pll_clk, pll_reset,
                pon_beamer, pri_mi2s, pri_mi2s_ws, prng_rosc, qdss_cti,
                qdss_gpio, qdss_gpio0, qdss_gpio1, qdss_gpio10, qdss_gpio11,
                qdss_gpio12, qdss_gpio13, qdss_gpio14, qdss_gpio15, qdss_gpio2,
                qdss_gpio3, qdss_gpio4, qdss_gpio5, qdss_gpio6, qdss_gpio7,
                qdss_gpio8, qdss_gpio9, qlink0_enable, qlink0_request,
                qlink0_wmss, qlink1_enable, qlink1_request, qlink1_wmss,
                qua_mi2s, qup00, qup01, qup02, qup04, qup05, qup10, qup11,
                qup12, qup13, qup14, qup15, sd_write, sdc40, sdc41, sdc42,
                sdc43, sdc4_clk, sdc4_cmd, sec_mi2s, ter_mi2s, tgu_ch0, tgu_ch1,
                tgu_ch2, tgu_ch3, tsense_pwm1, tsense_pwm2, uim1_clk, uim1_data,
                uim1_present, uim1_reset, uim2_clk, uim2_data, uim2_present,
                uim2_reset, uim_batt, usb2phy_ac, usb_phy, vfr_1,
                vsense_trigger, wlan1_adc0, wlan1_adc1, wlan2_adc0, wlan2_adc1 ]

    required:
      - pins

required:
  - compatible
  - reg
  - reg-names

unevaluatedProperties: false

examples:
  - |
    #include <dt-bindings/interrupt-controller/arm-gic.h>

    tlmm: pinctrl@f100000 {
        compatible = "qcom,sm7250-tlmm";
        reg = <0x0f100000 0x300000>,
              <0x0f500000 0x300000>,
              <0x0f900000 0x300000>;
        reg-names = "south", "west", "east";
        interrupts = <GIC_SPI 208 IRQ_TYPE_LEVEL_HIGH>;
        gpio-ranges = <&tlmm 0 0 146>;
        gpio-controller;
        #gpio-cells = <2>;
        interrupt-controller;
        #interrupt-cells = <2>;
        wakeup-parent = <&pdc>;

        gpio-wo-state {
            pins = "gpio1";
            function = "gpio";
        };

        uart-w-state {
            rx-pins {
                pins = "gpio36";
                function = "qup02";
                bias-pull-up;
            };

            tx-pins {
                pins = "gpio37";
                function = "qup02";
                bias-disable;
            };
        };
    };
...
```

## Documentation/devicetree/bindings/power/supply/convenientpower,cps8601.yaml
```yaml
# SPDX-License-Identifier: (GPL-2.0-only OR BSD-2-Clause)
%YAML 1.2
---
$id: http://devicetree.org/schemas/power/supply/convenientpower,cps8601.yaml#
$schema: http://devicetree.org/meta-schemas/core.yaml#

title: ConvenientPower CPS8601 wireless power transmitter

maintainers:
  - Travis Geisinger <travis@geisinger.dev>

description:
  The CPS8601 is a wireless power transmitter with its own firmware. On the
  OnePlus Pad 3 it runs OnePlus firmware and charges the docked stylus. Its
  coil is fed by a boost converter whose voltage the host sets; GPIOs wake
  the chip, switch its power and gate the transmitter.

allOf:
  - $ref: power-supply.yaml#

properties:
  compatible:
    const: convenientpower,cps8601

  reg:
    maxItems: 1

  interrupts:
    maxItems: 1

  vin-supply:
    description: Supply of the transmitter coil.

  wakeup-gpios:
    maxItems: 1
    description: GP0, keeps the firmware awake while high.

  scan-gpios:
    maxItems: 1
    description: GP1, held high while the host display is on.

  enable-gpios:
    maxItems: 1
    description: GP2, the power switch of the chip.

  tx-disable-gpios:
    maxItems: 1
    description: GP3, stops the transmitter while high.

  oneplus,idle-microvolt:
    description: Coil supply voltage while no stylus is attached.

  oneplus,charge-microvolt:
    description: Coil supply voltage while a stylus is attached.

required:
  - compatible
  - reg
  - interrupts
  - vin-supply
  - wakeup-gpios
  - scan-gpios
  - enable-gpios
  - tx-disable-gpios
  - oneplus,idle-microvolt
  - oneplus,charge-microvolt

unevaluatedProperties: false

examples:
  - |
    #include <dt-bindings/gpio/gpio.h>
    #include <dt-bindings/interrupt-controller/irq.h>

    i2c {
        #address-cells = <1>;
        #size-cells = <0>;

        pen-charger@41 {
            compatible = "convenientpower,cps8601";
            reg = <0x41>;
            interrupts-extended = <&tlmm 172 IRQ_TYPE_EDGE_FALLING>;
            vin-supply = <&pen_boost>;
            wakeup-gpios = <&tlmm 106 GPIO_ACTIVE_HIGH>;
            scan-gpios = <&tlmm 56 GPIO_ACTIVE_HIGH>;
            enable-gpios = <&tlmm 105 GPIO_ACTIVE_HIGH>;
            tx-disable-gpios = <&tlmm 107 GPIO_ACTIVE_HIGH>;
            oneplus,idle-microvolt = <7000000>;
            oneplus,charge-microvolt = <10000000>;
        };
    };
```

## Documentation/devicetree/bindings/power/supply/google,barbet-battery.yaml
```yaml
# SPDX-License-Identifier: (GPL-2.0-only OR BSD-2-Clause)
%YAML 1.2
---
$id: http://devicetree.org/schemas/power/supply/google,barbet-battery.yaml#
$schema: http://devicetree.org/meta-schemas/core.yaml#

title: Google Pixel 5a (barbet) battery gauge

description: |
  A voltage-only gauge for the Pixel 5a battery. It reads the PM7250B VADC
  battery voltage channel and reports the state of charge over a linear
  open-circuit window between the two voltage properties. The status follows
  the PM7250B charger when it is present.

maintainers:
  - Bronson <bronsonmathews@gmail.com>

properties:
  compatible:
    const: google,barbet-battery

  io-channels:
    maxItems: 1
    description: The VADC channel connected to the battery voltage sense.

  voltage-min-microvolt:
    default: 3200000
    description: Battery voltage reported as an empty battery.

  voltage-max-microvolt:
    default: 4350000
    description: Battery voltage reported as a full battery.

required:
  - compatible
  - io-channels

unevaluatedProperties: false

examples:
  - |
    battery {
        compatible = "google,barbet-battery";
        io-channels = <&pm7250b_adc 0x84>;
        voltage-min-microvolt = <3200000>;
        voltage-max-microvolt = <4350000>;
    };
...
```

## Documentation/devicetree/bindings/power/supply/qcom,pm7250b-charger.yaml
```yaml
# SPDX-License-Identifier: (GPL-2.0-only OR BSD-2-Clause)
%YAML 1.2
---
$id: http://devicetree.org/schemas/power/supply/qcom,pm7250b-charger.yaml#
$schema: http://devicetree.org/meta-schemas/core.yaml#

title: Qualcomm PM7250B switch-mode battery charger

description: |
  The charger block of the PM7250B. The driver reports the charging state and
  lets userspace stop and resume battery charging; it never touches current
  or voltage limits. When the hardware drives the charge-enable pin instead
  of the command register, charging can only be reported.

maintainers:
  - Bronson <bronsonmathews@gmail.com>

allOf:
  - $ref: power-supply.yaml#

properties:
  compatible:
    const: qcom,pm7250b-charger

  reg:
    maxItems: 1
    description: Offset of the charger peripheral within the PMIC.

  power-supplies:
    maxItems: 1
    description: |
      The fuel gauge the charge limit is read from. When it names a supply,
      the driver also implements a laptop style charge limit with
      charge_control_start_threshold and charge_control_end_threshold.

required:
  - compatible
  - reg

unevaluatedProperties: false

examples:
  - |
    pmic {
        #address-cells = <1>;
        #size-cells = <0>;

        charger@1000 {
            compatible = "qcom,pm7250b-charger";
            reg = <0x1000>;
        };
    };
...
```

## Documentation/devicetree/bindings/power/supply/siliconmitus,sm5714-fuel-gauge.yaml
```yaml
# SPDX-License-Identifier: GPL-2.0-only OR BSD-2-Clause
%YAML 1.2
---
$id: http://devicetree.org/schemas/power/supply/siliconmitus,sm5714-fuel-gauge.yaml#
$schema: http://devicetree.org/meta-schemas/core.yaml#

title: Silicon Mitus SM5714 fuel gauge

maintainers:
  - rafroad <rafan.second@gmail.com>

description:
  The fuel gauge of the SM5714 charger and power management chip. The
  charger block of the same chip answers at I2C address 0x49 on the same
  bus; the driver reads its status from there. The chip has one shared
  interrupt line for its charger, MUIC and gauge blocks.

allOf:
  - $ref: power-supply.yaml#

properties:
  compatible:
    const: siliconmitus,sm5714-fuel-gauge

  reg:
    maxItems: 1

  interrupts:
    maxItems: 1
    description: The chip's shared, level-low interrupt line.

  io-channels:
    maxItems: 1
    description:
      ADC channel of the battery's thermistor, processed to a temperature.
      The gauge's own temperature follows the chip, not the cells.

  io-channel-names:
    const: batt-therm

required:
  - compatible
  - reg
  - io-channels
  - io-channel-names

unevaluatedProperties: false

examples:
  - |
    #include <dt-bindings/iio/qcom,spmi-vadc.h>
    #include <dt-bindings/interrupt-controller/irq.h>

    i2c {
        #address-cells = <1>;
        #size-cells = <0>;

        fuel-gauge@71 {
            compatible = "siliconmitus,sm5714-fuel-gauge";
            reg = <0x71>;
            interrupts-extended = <&tlmm 84 IRQ_TYPE_LEVEL_LOW>;
            io-channels = <&pm6150l_adc ADC5_GPIO2_100K_PU>;
            io-channel-names = "batt-therm";
        };
    };
...
```
