## Documentation/devicetree/bindings/misc/goodix,g6.yaml
```yaml
# SPDX-License-Identifier: (GPL-2.0-only OR BSD-2-Clause)
%YAML 1.2
---
$id: http://devicetree.org/schemas/misc/goodix,g6.yaml#
$schema: http://devicetree.org/meta-schemas/core.yaml#

title: Goodix G6 optical fingerprint platform control

maintainers:
  - Noswad <64293615+TheNoswad@users.noreply.github.com>

description: |
  Power, reset and interrupt wiring for a Goodix G6 under-display optical
  fingerprint sensor. The secure world owns the sensor's SPI bus:
  Trusty drives the SPI controller and biometric commands go to the
  sensor's signed trusted application. Linux clocks that controller, so
  it keeps the controller's clocks running while the sensor is in use.

properties:
  compatible:
    const: goodix,g6

  reset-gpios:
    maxItems: 1
    description: Active-low sensor reset.

  interrupt-gpios:
    maxItems: 1
    description: Active-high sensor interrupt, sampled on the rising edge.

  clocks:
    minItems: 1
    maxItems: 3
    description:
      Clocks of the SPI controller the secure world drives the sensor
      through.

  vdd-supply:
    description: Sensor analog supply.

  pinctrl-0: true
  pinctrl-names:
    const: default

required:
  - compatible
  - reset-gpios
  - interrupt-gpios
  - clocks

additionalProperties: false

examples:
  - |
    #include <dt-bindings/clock/google,gs101.h>
    #include <dt-bindings/gpio/gpio.h>

    fingerprint {
        compatible = "goodix,g6";
        reset-gpios = <&gpp4 3 GPIO_ACTIVE_LOW>;
        interrupt-gpios = <&gpa9 2 GPIO_ACTIVE_HIGH>;
        clocks = <&cmu_peric1 CLK_GOUT_PERIC1_PERIC1_TOP0_PCLK_1>,
                 <&cmu_peric1 CLK_GOUT_PERIC1_PERIC1_TOP0_IPCLK_1>,
                 <&cmu_peric1 CLK_GOUT_PERIC1_CLK_PERIC1_USI0_USI_CLK>;
        vdd-supply = <&s2mpg10_ldo27m>;
    };
```

## Documentation/devicetree/bindings/net/bluetooth/qcom,bluetooth-common.yaml
```yaml
# SPDX-License-Identifier: (GPL-2.0 OR BSD-2-Clause)
%YAML 1.2
---
$id: http://devicetree.org/schemas/net/bluetooth/qcom,bluetooth-common.yaml#
$schema: http://devicetree.org/meta-schemas/core.yaml#

title: Qualcomm Bluetooth Common Properties

maintainers:
  - Balakrishna Godavarthi <quic_bgodavar@quicinc.com>
  - Rocky Liao <quic_rjliao@quicinc.com>

properties:
  firmware-name:
    minItems: 1
    items:
      - description: specify the name of nvm firmware to load
      - description: specify the name of rampatch firmware to load

  qcom,local-bd-address-broken:
    type: boolean
    description:
      boot firmware is incorrectly passing the address in big-endian order

  qcom,no-inband-sleep:
    type: boolean
    description:
      The board runs the controller without software in-band sleep, as its
      vendor NVM configures it. The host leaves the NVM's in-band sleep bit
      as shipped and does not use the sleep protocol on the UART.

additionalProperties: true
```

## Documentation/devicetree/bindings/pci/google,gs101-pcie.yaml
```yaml
# SPDX-License-Identifier: (GPL-2.0-only OR BSD-2-Clause)
%YAML 1.2
---
$id: http://devicetree.org/schemas/pci/google,gs101-pcie.yaml#
$schema: http://devicetree.org/meta-schemas/core.yaml#

title: Google gs101 PCIe host controller

maintainers:
  - Noswad <64293615+TheNoswad@users.noreply.github.com>

description:
  The Google gs101 SoC has two PCIe Gen4 root complexes based on the
  Synopsys DesignWare PCIe IP, each with its own two-lane PHY. Their
  interrupts, MSI among them, share one line.

properties:
  compatible:
    const: google,gs101-pcie

  reg:
    items:
      - description: External Local Bus interface (ELBI) registers
      - description: Data Bus Interface (DBI) registers
      - description: PCIe configuration space region

  reg-names:
    items:
      - const: elbi
      - const: dbi
      - const: config

  interrupts:
    maxItems: 1

  clocks:
    items:
      - description: DBI clock
      - description: AXI master clock
      - description: AXI slave clock
      - description: APB clock
      - description: Interrupt aggregator clock
      - description: DBI UASC AXI clock
      - description: DBI UASC APB clock
      - description: AXI slave UASC AXI clock
      - description: AXI slave UASC APB clock

  clock-names:
    items:
      - const: dbi
      - const: mstr
      - const: slv
      - const: apb
      - const: ia
      - const: uasc-dbi-aclk
      - const: uasc-dbi-pclk
      - const: uasc-slv-aclk
      - const: uasc-slv-pclk

  phys:
    maxItems: 1

  reset-gpios:
    description: GPIO driving PERST#
    maxItems: 1

  num-lanes:
    maximum: 2

  max-link-speed:
    maximum: 4

patternProperties:
  "^pcie@":
    type: object
    $ref: /schemas/pci/pci-pci-bridge.yaml#

    properties:
      reg:
        maxItems: 1

      clocks:
        description: Clock the endpoint needs to power up, such as a
          32 kHz sleep clock
        maxItems: 1

    unevaluatedProperties: false

required:
  - compatible
  - reg
  - reg-names
  - interrupts
  - "#interrupt-cells"
  - interrupt-map
  - interrupt-map-mask
  - ranges
  - clocks
  - clock-names
  - phys
  - reset-gpios

allOf:
  - $ref: /schemas/pci/pci-host-bridge.yaml#

unevaluatedProperties: false

examples:
  - |
    #include <dt-bindings/clock/google,gs101.h>
    #include <dt-bindings/gpio/gpio.h>
    #include <dt-bindings/interrupt-controller/arm-gic.h>

    soc {
        #address-cells = <1>;
        #size-cells = <1>;

        pcie@14520000 {
            compatible = "google,gs101-pcie";
            reg = <0x14520000 0x2000>,
                  <0x14800000 0x301000>,
                  <0x60ffe000 0x2000>;
            reg-names = "elbi", "dbi", "config";
            device_type = "pci";
            #address-cells = <3>;
            #size-cells = <2>;
            ranges = <0x82000000 0 0x60000000 0x60000000 0 0x00ff0000>;
            bus-range = <0x00 0xff>;
            linux,pci-domain = <1>;
            num-lanes = <2>;
            max-link-speed = <3>;
            interrupts = <GIC_SPI 509 IRQ_TYPE_LEVEL_HIGH 0>;
            #interrupt-cells = <1>;
            interrupt-map-mask = <0 0 0 0>;
            interrupt-map = <0 0 0 0 &gic GIC_SPI 509 IRQ_TYPE_LEVEL_HIGH 0>;
            clocks = <&cmu_hsi2 CLK_GOUT_HSI2_PCIE_GEN4_1_PCIE_003_DBI_ACLK_UG>,
                     <&cmu_hsi2 CLK_GOUT_HSI2_PCIE_GEN4_1_PCIE_003_MSTR_ACLK_UG>,
                     <&cmu_hsi2 CLK_GOUT_HSI2_PCIE_GEN4_1_PCIE_003_SLV_ACLK_UG>,
                     <&cmu_hsi2 CLK_GOUT_HSI2_PCIE_GEN4_1_PCIE_003_I_DRIVER_APB_CLK>,
                     <&cmu_hsi2 CLK_GOUT_HSI2_PCIE_IA_GEN4A_1_I_CLK>,
                     <&cmu_hsi2 CLK_GOUT_HSI2_UASC_PCIE_GEN4A_DBI_1_ACLK>,
                     <&cmu_hsi2 CLK_GOUT_HSI2_UASC_PCIE_GEN4A_DBI_1_PCLK>,
                     <&cmu_hsi2 CLK_GOUT_HSI2_UASC_PCIE_GEN4A_SLV_1_ACLK>,
                     <&cmu_hsi2 CLK_GOUT_HSI2_UASC_PCIE_GEN4A_SLV_1_PCLK>;
            clock-names = "dbi", "mstr", "slv", "apb", "ia",
                          "uasc-dbi-aclk", "uasc-dbi-pclk",
                          "uasc-slv-aclk", "uasc-slv-pclk";
            phys = <&pcie_phy1>;
            reset-gpios = <&gph2 0 GPIO_ACTIVE_LOW>;

            pcie@0 {
                compatible = "pciclass,0604";
                device_type = "pci";
                reg = <0x0 0x0 0x0 0x0 0x0>;
                bus-range = <0x01 0xff>;
                #address-cells = <3>;
                #size-cells = <2>;
                ranges;
            };
        };
    };
```

## Documentation/devicetree/bindings/phy/google,gs101-pcie-phy.yaml
```yaml
# SPDX-License-Identifier: (GPL-2.0-only OR BSD-2-Clause)
%YAML 1.2
---
$id: http://devicetree.org/schemas/phy/google,gs101-pcie-phy.yaml#
$schema: http://devicetree.org/meta-schemas/core.yaml#

title: Google gs101 PCIe PHY

maintainers:
  - Noswad <64293615+TheNoswad@users.noreply.github.com>

description:
  The two-lane PCIe Gen4 PHY of the Google gs101 SoC, one for each PCIe
  controller. The PHY's reset inputs are driven by its controller, which
  calls the PHY between asserting and releasing them.

properties:
  compatible:
    const: google,gs101-pcie-phy

  reg:
    items:
      - description: PMA registers
      - description: PCS registers

  reg-names:
    items:
      - const: pma
      - const: pcs

  clocks:
    items:
      - description: PIPE PAL APB clock
      - description: PHY Q-channel APB clock
      - description: PHY debug APB clock
      - description: PHY reference clock

  clock-names:
    items:
      - const: pipe-pal
      - const: qch
      - const: udbg
      - const: ref

  "#phy-cells":
    const: 0

  vdd085-supply:
    description: 0.85 V analog supply

  vdd18-supply:
    description: 1.8 V analog supply

  samsung,pmu-syscon:
    $ref: /schemas/types.yaml#/definitions/phandle-array
    items:
      - items:
          - description: phandle of the PMU
          - description: offset of this PHY's control register in the PMU
    description:
      The PMU register that isolates the PHY.

required:
  - compatible
  - reg
  - reg-names
  - clocks
  - clock-names
  - "#phy-cells"
  - samsung,pmu-syscon
  - vdd085-supply
  - vdd18-supply

additionalProperties: false

examples:
  - |
    #include <dt-bindings/clock/google,gs101.h>

    phy@14550000 {
        compatible = "google,gs101-pcie-phy";
        reg = <0x14550000 0x2000>, <0x14540000 0x1000>;
        reg-names = "pma", "pcs";
        clocks = <&cmu_hsi2 CLK_GOUT_HSI2_PCIE_GEN4_1_PCS_PMA_PIPE_PAL_PCIE_I_APB_PCLK>,
                 <&cmu_hsi2 CLK_GOUT_HSI2_PCIE_GEN4_1_PCS_PMA_PCIEPHY210X2_QCH_I_APB_PCLK>,
                 <&cmu_hsi2 CLK_GOUT_HSI2_PCIE_GEN4_1_PCS_PMA_PHY_UDBG_I_APB_PCLK>,
                 <&cmu_hsi2 CLK_GOUT_HSI2_PCIE_GEN4_1_PCIE_003_PHY_REFCLK_IN>;
        clock-names = "pipe-pal", "qch", "udbg", "ref";
        #phy-cells = <0>;
        samsung,pmu-syscon = <&pmu_system_controller 0x3ec4>;
        vdd085-supply = <&s2mpg10_ldo17m>;
        vdd18-supply = <&s2mpg10_ldo19m>;
    };
```

## Documentation/devicetree/bindings/phy/sprd,ums9230-hsphy.yaml
```yaml
# SPDX-License-Identifier: (GPL-2.0-only OR BSD-2-Clause)
%YAML 1.2
---
$id: http://devicetree.org/schemas/phy/sprd,ums9230-hsphy.yaml#
$schema: http://devicetree.org/meta-schemas/core.yaml#

title: Unisoc UMS9230 USB 2.0 PHY

maintainers:
  - Otto Pflüger <otto.pflueger@abscue.de>

properties:
  compatible:
    const: sprd,ums9230-hsphy

  reg:
    maxItems: 1

  '#phy-cells':
    const: 0

  sprd,syscon-aon-apb:
    $ref: /schemas/types.yaml#/definitions/phandle
    description: Always-on APB global register syscon.

required:
  - compatible
  - reg
  - '#phy-cells'
  - sprd,syscon-aon-apb

additionalProperties: false
```
