## Documentation/devicetree/bindings/power/supply/southchip,sc8547.yaml
```yaml
# SPDX-License-Identifier: GPL-2.0-only OR BSD-2-Clause
%YAML 1.2
---
$id: http://devicetree.org/schemas/power/supply/southchip,sc8547.yaml#
$schema: http://devicetree.org/meta-schemas/core.yaml#

title: Southchip SC8547A and SC8547D 2:1 charge pumps

maintainers:
  - Sebastian Reichel <sre@kernel.org>

description: |
  The SC8547A and SC8547D are 2:1 switched-capacitor charge pumps for
  single-cell batteries. It measures its input, output and battery, and stops on its
  own protection limits or when its watchdog expires. Some boards also use
  its built-in VOOC PHY, which talks to the adapter over USB D+/D- while a
  direct charging driver runs the pump.

properties:
  compatible:
    enum:
      - southchip,sc8547a
      - southchip,sc8547d
      # Either the A or the D, resolved from the device ID at probe.
      - southchip,sc8547

  reg:
    maxItems: 1

  interrupts:
    maxItems: 1

  southchip,vbat-ovp-microvolt:
    description: Battery overvoltage limit.
    minimum: 3500000
    maximum: 5075000
    multipleOf: 25000
    default: 4650000

  southchip,vbus-ovp-microvolt:
    description: Input overvoltage limit.
    minimum: 6000000
    maximum: 12350000
    multipleOf: 50000
    default: 10000000

  southchip,ibus-ocp-microamp:
    description: Input overcurrent limit.
    minimum: 1200000
    maximum: 5700000
    multipleOf: 300000
    default: 3600000

  southchip,switching-frequency-hz:
    enum: [500000, 600000]
    default: 500000

  southchip,always-otg-en:
    type: boolean
    description: Keep the OTG enable bit set at all times.

  vooc-phy:
    type: object
    description: The built-in VOOC PHY, used by a direct charging driver.
    additionalProperties: false

    properties:
      mux-states:
        description: Routes USB D+/D- from the connector to the PHY.
        maxItems: 1

      io-channels:
        items:
          - description: USB connector thermistor
          - description: Battery connector thermistor
          - description: Board thermistor
          - description: Charge pump MOSFET thermistor

      io-channel-names:
        items:
          - const: usb-connector
          - const: battery-connector
          - const: board
          - const: mos

      southchip,secondary-pump:
        $ref: /schemas/types.yaml#/definitions/phandle
        description: A second SC8547D sharing the charging current.

      oneplus,svooc-max-microamp:
        description:
          The highest adapter current a SuperVOOC session may ask for, below
          the driver's own limit.
        minimum: 1500000
        maximum: 6200000
        multipleOf: 100000

      oneplus,svooc-battery-curve:
        $ref: /schemas/types.yaml#/definitions/uint32-matrix
        description:
          The battery curve the SuperVOOC adapter reads before charging, as
          three pairs of battery voltage in microvolts and current in
          microamps.
        minItems: 3
        maxItems: 3
        items:
          items:
            - minimum: 3404000
              maximum: 4664000
            - minimum: 100000
              maximum: 12700000
              multipleOf: 100000

      oneplus,svooc-adapters:
        $ref: /schemas/types.yaml#/definitions/uint32-matrix
        description:
          The SuperVOOC adapters the board charges from, as ranges of the
          model number the adapter reports, each with the power it may
          deliver in microwatts. A session with an adapter outside these
          ranges, or with no power, goes back to standard charging before
          the adapter raises VBUS.
        minItems: 1
        maxItems: 64
        items:
          items:
            - description: First model number of the range
              maximum: 0x7f
            - description: Last model number of the range
              maximum: 0x7f
            - description: Adapter power in microwatts
              maximum: 240000000

      oneplus,svooc-soc-bands:
        $ref: /schemas/types.yaml#/definitions/uint32-array
        description:
          The highest state of charge of each charge curve band, in percent.
          A session starts only up to the last one and keeps the band it
          started in until it changes temperature band.
        minItems: 1
        maxItems: 8
        items:
          maximum: 100

      oneplus,svooc-temp-bands:
        $ref: /schemas/types.yaml#/definitions/int32-array
        description:
          Battery temperatures in tenths of a degree Celsius bounding the
          charge curve temperature bands, in rising order; band n spans
          entries n and n + 1. A session starts only between the first and
          the last.
        minItems: 2
        maxItems: 9

      oneplus,svooc-full-microvolt:
        description:
          For each temperature band, the battery voltage that ends a
          session at once and the one that ends it when held.
        minItems: 1
        maxItems: 8
        items:
          items:
            - minimum: 3500000
              maximum: 4700000
            - minimum: 3500000
              maximum: 4700000

      oneplus,svooc-stock-strategy:
        type: boolean
        description:
          Charge by the charge curves, the full voltages, the low-current
          full thresholds and the time limit below, rather than by the
          driver's own rules.

      oneplus,svooc-fast-full-charge:
        type: boolean
        description:
          After a session by the charge curves ends full, run the top-up
          charge described in fast-full-charge.

      oneplus,svooc-overvoltage-microvolt:
        description: A battery voltage that stops a session as a fault.
        minimum: 3500000
        maximum: 4800000

      oneplus,svooc-timeout-sec:
        description: The longest a session may charge.
        minimum: 60

      charge-curves:
        type: object
        description:
          The adapter current for each state of charge band, temperature
          band and battery voltage. A session starts at the first step whose
          voltage the battery has not passed, moves on once the battery
          stays above it, and holds the last step until the battery is full.
        additionalProperties: false

        patternProperties:
          "^soc-band-[0-7]$":
            type: object
            additionalProperties: false

            patternProperties:
              "^temp-band-[0-7]$":
                $ref: /schemas/types.yaml#/definitions/uint32-matrix
                description:
                  Pairs of battery voltage in microvolts and adapter current
                  in microamps.
                minItems: 1
                maxItems: 16
                items:
                  items:
                    - minimum: 3500000
                      maximum: 4700000
                    - minimum: 100000
                      maximum: 12700000
                      multipleOf: 100000

      low-current-full:
        type: object
        description:
          Ends a session once the battery current falls to a threshold at or
          above a battery voltage, for each temperature band.
        additionalProperties: false

        properties:
          temp-bands:
            $ref: /schemas/types.yaml#/definitions/int32-array
            description:
              Battery temperatures in tenths of a degree Celsius bounding
              the bands, in rising order.
            minItems: 2
            maxItems: 9

        patternProperties:
          "^temp-band-[0-7]$":
            $ref: /schemas/types.yaml#/definitions/uint32-matrix
            description:
              Pairs of battery current in microamps and battery voltage in
              microvolts.
            minItems: 1
            maxItems: 6
            items:
              items:
                - maximum: 12700000
                - minimum: 3500000
                  maximum: 4700000

        required:
          - temp-bands

      fast-full-charge:
        type: object
        description:
          After a session ends full, the standard charger tops the battery
          up at a raised voltage limit and a low current, in steps, while
          the battery temperature stays within the bands.
        additionalProperties: false

        properties:
          temp-bands:
            $ref: /schemas/types.yaml#/definitions/int32-array
            description:
              Battery temperatures in tenths of a degree Celsius bounding
              the bands, in rising order.
            minItems: 2
            maxItems: 9

          restore-microvolt:
            description:
              For each temperature band, the voltage limit the standard
              charger gets back after the top-up.
            minItems: 1
            maxItems: 8
            items:
              minimum: 3500000
              maximum: 4700000

          skip-microvolt:
            description:
              A battery voltage at which a full battery skips the top-up.
            minimum: 3500000
            maximum: 4700000

          steps:
            $ref: /schemas/types.yaml#/definitions/uint32-matrix
            description:
              For each step and temperature band, the voltage limit and the
              charge current in microvolts and microamps, and the battery
              voltage and current that end the step.
            minItems: 1
            maxItems: 40
            items:
              items:
                - minimum: 3500000
                  maximum: 4700000
                - maximum: 12700000
                - minimum: 3500000
                  maximum: 4700000
                - maximum: 12700000

        required:
          - temp-bands
          - restore-microvolt
          - steps

    dependentRequired:
      oneplus,svooc-soc-bands:
        - oneplus,svooc-temp-bands
        - oneplus,svooc-full-microvolt
        - charge-curves
      charge-curves:
        - oneplus,svooc-soc-bands
      oneplus,svooc-stock-strategy:
        - oneplus,svooc-soc-bands
      oneplus,svooc-fast-full-charge:
        - oneplus,svooc-stock-strategy
        - fast-full-charge

    required:
      - mux-states
      - io-channels
      - io-channel-names
      - oneplus,svooc-battery-curve

required:
  - compatible
  - reg

allOf:
  - if:
      required:
        - vooc-phy
    then:
      required:
        - interrupts

additionalProperties: false

examples:
  - |
    #include <dt-bindings/interrupt-controller/irq.h>

    i2c {
        #address-cells = <1>;
        #size-cells = <0>;

        charge-pump@6a {
            compatible = "southchip,sc8547d";
            reg = <0x6a>;
            interrupt-parent = <&tlmm>;
            interrupts = <0 IRQ_TYPE_EDGE_FALLING>;
            southchip,vbat-ovp-microvolt = <4850000>;
            southchip,vbus-ovp-microvolt = <10500000>;
            southchip,ibus-ocp-microamp = <3600000>;
            southchip,always-otg-en;

            vooc-phy {
                mux-states = <&usbss 1>;
                io-channels = <&adc 0x2747>, <&adc 0x2744>,
                              <&adc 0x274d>, <&adc 0x274b>;
                io-channel-names = "usb-connector", "battery-connector",
                                   "board", "mos";
                southchip,secondary-pump = <&second_pump>;
                oneplus,svooc-battery-curve = <4664000 1100000>,
                                              <4664000 2600000>,
                                              <3414000 7300000>;
            };
        };
    };
```

## Documentation/devicetree/bindings/regulator/maxim,max77816.yaml
```yaml
# SPDX-License-Identifier: GPL-2.0-only OR BSD-2-Clause
%YAML 1.2
---
$id: http://devicetree.org/schemas/regulator/maxim,max77816.yaml#
$schema: http://devicetree.org/meta-schemas/core.yaml#

title: Maxim MAX77816 buck-boost regulator

maintainers:
  - rafroad <rafan.second@gmail.com>

description:
  A buck-boost with I2C control, used as a fixed 5.0 V supply switched by
  its EN pin; the driver sets the output to 5.0 V after each enable.

allOf:
  - $ref: regulator.yaml#

properties:
  compatible:
    const: maxim,max77816

  reg:
    maxItems: 1

  enable-gpios:
    maxItems: 1

required:
  - compatible
  - reg
  - enable-gpios

unevaluatedProperties: false

examples:
  - |
    #include <dt-bindings/gpio/gpio.h>

    i2c {
        #address-cells = <1>;
        #size-cells = <0>;

        regulator@18 {
            compatible = "maxim,max77816";
            reg = <0x18>;
            enable-gpios = <&tlmm 72 GPIO_ACTIVE_HIGH>;
            regulator-name = "backlight_boost";
            regulator-min-microvolt = <5000000>;
            regulator-max-microvolt = <5000000>;
        };
    };
...
```

## Documentation/devicetree/bindings/regulator/willsemi,wl2866d.yaml
```yaml
# SPDX-License-Identifier: GPL-2.0-only OR BSD-2-Clause
%YAML 1.2
---
$id: http://devicetree.org/schemas/regulator/willsemi,wl2866d.yaml#
$schema: http://devicetree.org/meta-schemas/core.yaml#

title: Will Semiconductor WL2866D camera LDOs

maintainers:
  - Doctor Logix <doctor.logix@gmail.com>

description:
  Four I2C programmable low dropout regulators for camera modules. LDO1 and
  LDO2 run from VIN1, LDO3 and LDO4 from VIN2.

properties:
  compatible:
    const: willsemi,wl2866d

  reg:
    maxItems: 1

  vin1-supply:
    description: Input of LDO1 and LDO2

  vin2-supply:
    description: Input of LDO3 and LDO4

  regulators:
    type: object
    additionalProperties: false

    patternProperties:
      "^ldo[1-4]$":
        type: object
        $ref: regulator.yaml#
        unevaluatedProperties: false

required:
  - compatible
  - reg
  - regulators

additionalProperties: false

examples:
  - |
    i2c {
        #address-cells = <1>;
        #size-cells = <0>;

        regulator@28 {
            compatible = "willsemi,wl2866d";
            reg = <0x28>;

            regulators {
                ldo1 {
                    regulator-min-microvolt = <1000000>;
                    regulator-max-microvolt = <1000000>;
                };
            };
        };
    };
...
```
