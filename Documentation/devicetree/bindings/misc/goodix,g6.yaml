## Documentation/devicetree/bindings/sound/ti,tas2562.yaml
```yaml
# SPDX-License-Identifier: (GPL-2.0-only OR BSD-2-Clause)
# Copyright (C) 2019 Texas Instruments Incorporated
%YAML 1.2
---
$id: http://devicetree.org/schemas/sound/ti,tas2562.yaml#
$schema: http://devicetree.org/meta-schemas/core.yaml#

title: Texas Instruments TAS2562 Smart PA

maintainers:
  - Andrew Davis <afd@ti.com>

description: |
  The TAS2562 is a mono, digital input Class-D audio amplifier optimized for
  efficiently driving high peak power into small loudspeakers.
  Integrated speaker voltage and current sense provides for
  real time monitoring of loudspeaker behavior.

  Specifications about the audio amplifier can be found at:
    https://www.ti.com/lit/gpn/tas2562
    https://www.ti.com/lit/gpn/tas2564
    https://www.ti.com/lit/gpn/tas2110

allOf:
  - $ref: dai-common.yaml#

properties:
  compatible:
    enum:
      - ti,tas2562
      - ti,tas2564
      - ti,tas2110

  reg:
    maxItems: 1
    description: |
       I2C address of the device can be one of these 0x4c, 0x4d, 0x4e or 0x4f

  shut-down-gpios:
    maxItems: 1
    description: GPIO used to control the state of the device.
    deprecated: true

  shutdown-gpios:
    maxItems: 1
    description: GPIO used to control the state of the device.

  reset-gpios:
    minItems: 1
    maxItems: 2
    description: |
      GPIO used to control the state of the device. A second entry resets the
      right amplifier of a pair (see ti,left-channel).

  interrupts:
    maxItems: 1

  ti,imon-slot-no:
    $ref: /schemas/types.yaml#/definitions/uint32
    description: TDM TX current sense time slot.

  ti,left-channel:
    $ref: /schemas/types.yaml#/definitions/uint32
    description: |
      I2C address of the left amplifier of a stereo pair. When both this and
      ti,right-channel are present, one node describes both amplifiers: the
      driver drives the left one through this node's I2C client and the right
      one through a dummy client at ti,right-channel.

  ti,right-channel:
    $ref: /schemas/types.yaml#/definitions/uint32
    description: I2C address of the right amplifier of a stereo pair.

  '#sound-dai-cells':
    # The codec has a single DAI, the #sound-dai-cells=<1>; case is left in for backward
    # compatibility but is deprecated.
    enum: [0, 1]

required:
  - compatible
  - reg

unevaluatedProperties: false

examples:
  - |
    #include <dt-bindings/gpio/gpio.h>

    i2c {
        #address-cells = <1>;
        #size-cells = <0>;

        codec@4c {
            compatible = "ti,tas2562";
            reg = <0x4c>;
            #sound-dai-cells = <0>;
            interrupt-parent = <&gpio1>;
            interrupts = <14>;
            shutdown-gpios = <&gpio1 15 GPIO_ACTIVE_HIGH>;
            ti,imon-slot-no = <0>;
        };
    };
  - |
    #include <dt-bindings/gpio/gpio.h>

    i2c {
        #address-cells = <1>;
        #size-cells = <0>;

        // One node drives both amplifiers of a stereo pair.
        speaker-amp@4c {
            compatible = "ti,tas2562";
            reg = <0x4c>;
            #sound-dai-cells = <1>;
            reset-gpios = <&gpio1 10 GPIO_ACTIVE_HIGH>,
                          <&gpio1 11 GPIO_ACTIVE_HIGH>;
            ti,left-channel = <0x4c>;
            ti,right-channel = <0x4d>;
        };
    };
```

## Documentation/devicetree/bindings/usb/sprd,ums9230-musb.yaml
```yaml
# SPDX-License-Identifier: (GPL-2.0-only OR BSD-2-Clause)
%YAML 1.2
---
$id: http://devicetree.org/schemas/usb/sprd,ums9230-musb.yaml#
$schema: http://devicetree.org/meta-schemas/core.yaml#

title: Unisoc UMS9230 MUSB controller

maintainers:
  - Otto Pflüger <otto.pflueger@abscue.de>

allOf:
  - $ref: usb-drd.yaml#

properties:
  compatible:
    items:
      - const: sprd,ums9230-musb
      - const: sprd,musb

  reg:
    maxItems: 1

  interrupts:
    maxItems: 1

  interrupt-names:
    const: mc

  clocks:
    maxItems: 1

  phys:
    maxItems: 1

required:
  - compatible
  - reg
  - interrupts
  - interrupt-names
  - clocks
  - phys

unevaluatedProperties: false
```

## drivers/trusty/Kconfig
```kconfig
# SPDX-License-Identifier: GPL-2.0-only
#
# Trusty driver
#

menu "Trusty driver"

config TRUSTY
	tristate "Trusty core driver"
	depends on ARM || ARM64
	help
	  Trusty is a secure OS that provides a Trusted Execution Environment
	  (TEE) for Android.  Trusty runs on the same processor as Linux but is
	  isolated from the rest of the system by both hardware and software.

	  This option enables the core part of the Linux kernel driver for
	  Trusty.  This doesn't do much by itself; you'll need to enable some of
	  the sub-modules too.

	  If you build this as a module, it will be called trusty-core.

if TRUSTY

config TRUSTY_CRASH_IS_PANIC
	bool "When trusty panics, then panic the kernel"
	help
	  This option will treat Trusty panics as fatal.  This is useful if
	  your system cannot recover from Trusty panic/halt and you require
	  the system to reboot to recover.

	  If N, it will continue to run the kernel, but trusty operations will
	  return errors.

endif # TRUSTY

endmenu
```
