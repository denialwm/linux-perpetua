## Documentation/devicetree/bindings/firmware/android,trusty.yaml
```yaml
# SPDX-License-Identifier: (GPL-2.0-only OR BSD-2-Clause)
%YAML 1.2
---
$id: http://devicetree.org/schemas/firmware/android,trusty.yaml#
$schema: http://devicetree.org/meta-schemas/core.yaml#

title: Trusty secure OS

maintainers:
  - Noswad <64293615+TheNoswad@users.noreply.github.com>

description:
  Trusty is the secure OS of Android's Trusted Execution Environment. It
  runs beside Linux on the same CPUs, in the secure world, and Linux reaches
  it through SMC calls. The bootloader starts it; the node only tells Linux
  that it is there and which of its services to use.

properties:
  compatible:
    const: android,trusty-smc-v1

  irq:
    type: object
    additionalProperties: false
    description:
      Forwards to Trusty the non-secure interrupts it asks for. Trusty names
      its interrupts by its own numbers; ipi-range maps a range of them onto
      the software-generated interrupts (SGIs) Linux leaves unused.

    properties:
      compatible:
        const: android,trusty-irq-v1

      ipi-range:
        $ref: /schemas/types.yaml#/definitions/uint32-array
        items:
          - description: first Trusty interrupt of the range
          - description: last Trusty interrupt of the range
          - description: SGI that the first one maps to
            maximum: 15

      interrupt-templates:
        $ref: /schemas/types.yaml#/definitions/uint32-matrix
        description:
          Interrupt specifiers without their number, each led by the phandle
          of the interrupt controller and the position of the number in the
          specifier.

      interrupt-ranges:
        $ref: /schemas/types.yaml#/definitions/uint32-matrix
        description:
          Ranges of Trusty interrupts, each as its first and last number and
          the index of the interrupt-templates entry that describes them.
        items:
          items:
            - description: first Trusty interrupt of the range
            - description: last Trusty interrupt of the range
            - description: index into interrupt-templates

    required:
      - compatible

  log:
    type: object
    additionalProperties: false
    description: Copies Trusty's log into the kernel log.

    properties:
      compatible:
        const: android,trusty-log-v1

    required:
      - compatible

  virtio:
    type: object
    additionalProperties: false
    description:
      The virtio devices Trusty offers, among them the IPC channel to its
      services.

    properties:
      compatible:
        const: android,trusty-virtio-v1

    required:
      - compatible

required:
  - compatible

additionalProperties: false

examples:
  - |
    firmware {
        trusty {
            compatible = "android,trusty-smc-v1";

            irq {
                compatible = "android,trusty-irq-v1";
                ipi-range = <8 15 8>;
            };

            log {
                compatible = "android,trusty-log-v1";
            };

            virtio {
                compatible = "android,trusty-virtio-v1";
            };
        };
    };
```

## Documentation/devicetree/bindings/input/awinic,aw96205.yaml
```yaml
# SPDX-License-Identifier: (GPL-2.0-only OR BSD-2-Clause)
%YAML 1.2
---
$id: http://devicetree.org/schemas/input/awinic,aw96205.yaml#
$schema: http://devicetree.org/meta-schemas/core.yaml#

title: Awinic AW9620x capacitive sensor as a key

maintainers:
  - Doctor Logix <doctor.logix@gmail.com>

description:
  The AW9620x capacitive proximity sensors run a program from their own
  flash and take their configuration from a register file. Used as a key,
  the sensor reports its first channel past its first threshold as one
  key press, such as a phone's shoulder trigger.

allOf:
  - $ref: input.yaml#

properties:
  compatible:
    const: awinic,aw96205

  reg:
    maxItems: 1

  interrupts:
    maxItems: 1

  vcc-supply: true

  firmware-name:
    maxItems: 1
    description: The vendor register file that configures the sensor.

  label:
    description: The input device's name.

  linux,code: true

required:
  - compatible
  - reg
  - interrupts
  - vcc-supply
  - firmware-name
  - linux,code

unevaluatedProperties: false

examples:
  - |
    #include <dt-bindings/input/input.h>
    #include <dt-bindings/interrupt-controller/irq.h>

    i2c {
        #address-cells = <1>;
        #size-cells = <0>;

        trigger@13 {
            compatible = "awinic,aw96205";
            reg = <0x13>;
            interrupts-extended = <&tlmm 200 IRQ_TYPE_EDGE_FALLING>;
            vcc-supply = <&vreg_l9b_2p9>;
            firmware-name = "aw9620x_reg_0.bin";
            label = "Left shoulder trigger";
            linux,code = <KEY_MACRO1>;
        };
    };
```

## Documentation/devicetree/bindings/input/cirrus,cs40l25a.yaml
```yaml
# SPDX-License-Identifier: GPL-2.0-only OR BSD-2-Clause
%YAML 1.2
---
$id: http://devicetree.org/schemas/input/cirrus,cs40l25a.yaml#
$schema: http://devicetree.org/meta-schemas/core.yaml#

title: Cirrus Logic CS40L25A Boosted Haptic Driver

maintainers:
  - Noswad <64293615+TheNoswad@users.noreply.github.com>

description:
  The CS40L25A drives a linear resonant actuator (LRA) from its internal
  boost converter. Its Halo Core DSP runs firmware loaded by the host,
  which plays the effects of a wavetable and timed vibrations.

properties:
  compatible:
    enum:
      - cirrus,cs40l25a

  reg:
    maxItems: 1

  interrupts:
    maxItems: 1

  reset-gpios:
    maxItems: 1

  clocks:
    maxItems: 1
    description:
      The 32.768 kHz reference clock on the MCLK/GPIO2 pin, which the DSP
      runs from.

  va-supply:
    description: Power supply for the analog and digital circuits (VA).

  vp-supply:
    description: Power supply for the boost converter (VP).

  firmware-name:
    maxItems: 1
    description:
      The DSP firmware (.wmfw) to load. A coefficient file of the same name
      ending in .bin, when present, is loaded after the wavetable.
    default: cs40l25a.wmfw

  cirrus,boost-ind-nanohenry:
    description: Inductance of the boost inductor.
    enum: [1000, 1200, 1500, 2200]

  cirrus,boost-cap-microfarad:
    description: Total equivalent capacitance on VBST.

  cirrus,boost-peak-milliamp:
    description: Peak current limit of the boost converter.
    minimum: 1600
    maximum: 4500
    multipleOf: 50

  cirrus,boost-ctl-millivolt:
    $ref: /schemas/types.yaml#/definitions/uint32
    description: Boost converter output voltage.
    minimum: 2550
    maximum: 11000
    multipleOf: 50
    default: 11000

  cirrus,boost-ovp-millivolt:
    $ref: /schemas/types.yaml#/definitions/uint32
    description:
      Overvoltage protection threshold of the boost converter. The
      chip's default is kept when absent.
    minimum: 9000
    maximum: 12875
    multipleOf: 125

  cirrus,boost-dcm-disable:
    type: boolean
    description:
      Keep the boost converter out of discontinuous conduction mode.

required:
  - compatible
  - reg
  - interrupts
  - reset-gpios
  - cirrus,boost-ind-nanohenry
  - cirrus,boost-cap-microfarad
  - cirrus,boost-peak-milliamp

additionalProperties: false

examples:
  - |
    #include <dt-bindings/gpio/gpio.h>
    #include <dt-bindings/interrupt-controller/irq.h>

    i2c {
      #address-cells = <1>;
      #size-cells = <0>;

      haptic-driver@43 {
        compatible = "cirrus,cs40l25a";
        reg = <0x43>;
        interrupt-parent = <&gpa6>;
        interrupts = <5 IRQ_TYPE_LEVEL_LOW>;
        reset-gpios = <&gpp24 0 GPIO_ACTIVE_LOW>;
        clocks = <&s2mpg10_clk 1>;
        firmware-name = "cs40l25a_clab.wmfw";
        cirrus,boost-ind-nanohenry = <1000>;
        cirrus,boost-cap-microfarad = <4>;
        cirrus,boost-peak-milliamp = <4500>;
        cirrus,boost-ctl-millivolt = <7500>;
        cirrus,boost-ovp-millivolt = <12000>;
        cirrus,boost-dcm-disable;
      };
    };
```

## Documentation/devicetree/bindings/input/oneplus,erhai-pogo-keyboard.yaml
```yaml
# SPDX-License-Identifier: (GPL-2.0-only OR BSD-2-Clause)
%YAML 1.2
---
$id: http://devicetree.org/schemas/input/oneplus,erhai-pogo-keyboard.yaml#
$schema: http://devicetree.org/meta-schemas/core.yaml#

title: OnePlus Pad 3 pogo-pin keyboard

maintainers:
  - Travis Geisinger <travis@geisinger.dev>

description:
  The keyboard covers of the OnePlus Pad 3 attach through pogo pins that
  carry their supply and one data line. The tablet drives the line from a
  UART through a line driver it enables while transmitting; an attached
  keyboard pulls the line low, which a GPIO senses.

allOf:
  - $ref: /schemas/serial/serial-peripheral-props.yaml#

properties:
  compatible:
    const: oneplus,erhai-pogo-keyboard

  vcc-supply:
    description: Supply of the keyboard on the pogo pins.

  tx-enable-gpios:
    maxItems: 1
    description: Enables the line driver while the UART transmits.

  detect-gpios:
    maxItems: 1
    description: Senses the data line, low while a keyboard is attached.

  max-speed: true

  oneplus,touchpad-size:
    $ref: /schemas/types.yaml#/definitions/uint32-array
    description: Range of the touchpad of the keyboard covers.
    items:
      - description: maximum X coordinate of the touchpad
      - description: maximum Y coordinate of the touchpad

  oneplus,touchpad-resolution:
    $ref: /schemas/types.yaml#/definitions/uint32-array
    description: Resolution of the touchpad of the keyboard covers.
    items:
      - description: X resolution of the touchpad, in units per mm
      - description: Y resolution of the touchpad, in units per mm

required:
  - compatible
  - vcc-supply
  - tx-enable-gpios
  - detect-gpios
  - max-speed

dependencies:
  oneplus,touchpad-resolution: [ 'oneplus,touchpad-size' ]

unevaluatedProperties: false

examples:
  - |
    #include <dt-bindings/gpio/gpio.h>

    serial {
        mcu {
            compatible = "oneplus,erhai-pogo-keyboard";
            vcc-supply = <&pogo_vcc>;
            tx-enable-gpios = <&tlmm 83 GPIO_ACTIVE_HIGH>;
            detect-gpios = <&tlmm 96 GPIO_ACTIVE_HIGH>;
            max-speed = <921600>;
            oneplus,touchpad-size = <2764 1630>;
            oneplus,touchpad-resolution = <23 23>;
        };
    };
```

## Documentation/devicetree/bindings/input/samsung,pogo-keyboard.yaml
```yaml
# SPDX-License-Identifier: (GPL-2.0-only OR BSD-2-Clause)
%YAML 1.2
---
$id: http://devicetree.org/schemas/input/samsung,pogo-keyboard.yaml#
$schema: http://devicetree.org/meta-schemas/core.yaml#

title: Samsung Book Cover Keyboard on the pogo connector

maintainers:
  - rafroad <rafan.second@gmail.com>

description:
  The Book Cover Keyboards of the Galaxy Tab S7 FE (EF-DT730 Slim and
  EF-DT970) attach through pogo pins. Their STM32 microcontroller answers
  on I2C while the tablet powers it, which it does while the connect line
  is high. The microcontroller reports keys as matrix positions.

allOf:
  - $ref: /schemas/input/matrix-keymap.yaml#

properties:
  compatible:
    const: samsung,pogo-keyboard

  reg:
    maxItems: 1

  interrupts:
    maxItems: 1
    description: Level-low event line of the keyboard microcontroller.

  vdd-supply:
    description: Supply of the keyboard on the pogo pins.

  connect-gpios:
    maxItems: 1
    description: High while a keyboard is attached.

  reset-gpios:
    maxItems: 1
    description: Reset of the keyboard microcontroller.

  linux,keymap: true

  samsung,keymap-slim:
    $ref: /schemas/types.yaml#/definitions/uint32-array
    description:
      Keymap of the EF-DT730 Slim cover, in the linux,keymap format. Its
      matrix differs from the EF-DT970's, which uses linux,keymap.

required:
  - compatible
  - reg
  - interrupts
  - vdd-supply
  - connect-gpios
  - reset-gpios
  - linux,keymap

unevaluatedProperties: false

examples:
  - |
    #include <dt-bindings/gpio/gpio.h>
    #include <dt-bindings/input/input.h>
    #include <dt-bindings/interrupt-controller/irq.h>

    i2c {
        #address-cells = <1>;
        #size-cells = <0>;

        keyboard@2a {
            compatible = "samsung,pogo-keyboard";
            reg = <0x2a>;
            interrupts-extended = <&tlmm 9 IRQ_TYPE_LEVEL_LOW>;
            connect-gpios = <&tlmm 8 GPIO_ACTIVE_HIGH>;
            reset-gpios = <&tlmm 10 GPIO_ACTIVE_LOW>;
            vdd-supply = <&vreg_l6a>;
            linux,keymap = <MATRIX_KEY(0, 4, KEY_Q)>;
            samsung,keymap-slim = <MATRIX_KEY(0, 4, KEY_Q)>;
        };
    };
...
```

## Documentation/devicetree/bindings/input/ti,drv2624.yaml
```yaml
# SPDX-License-Identifier: (GPL-2.0-only OR BSD-2-Clause)
%YAML 1.2
---
$id: http://devicetree.org/schemas/input/ti,drv2624.yaml#
$schema: http://devicetree.org/meta-schemas/core.yaml#

title: Texas Instruments DRV2624 haptic driver

description: |
  The DRV2624 is a closed-loop and open-loop haptic driver with a Class-D
  amplifier. The driver exposes it as a simple rumble effect through the
  force feedback interface and drives it in real-time playback mode.

maintainers:
  - Bronson <bronsonmathews@gmail.com>

properties:
  compatible:
    const: ti,drv2624

  reg:
    maxItems: 1

  reset-gpios:
    maxItems: 1
    description: Reset line of the controller.

  ti,rated-voltage:
    $ref: /schemas/types.yaml#/definitions/uint8
    default: 0x6d
    description: Rated voltage of the actuator, as the register value.

  ti,odclamp-voltage:
    $ref: /schemas/types.yaml#/definitions/uint8
    default: 0xa1
    description: Overdrive clamp voltage of the actuator, as the register value.

required:
  - compatible
  - reg

unevaluatedProperties: false

examples:
  - |
    #include <dt-bindings/gpio/gpio.h>

    i2c {
        #address-cells = <1>;
        #size-cells = <0>;

        haptics@5a {
            compatible = "ti,drv2624";
            reg = <0x5a>;
            reset-gpios = <&pm7250b_gpios 1 GPIO_ACTIVE_HIGH>;
            ti,rated-voltage = /bits/ 8 <109>;
            ti,odclamp-voltage = /bits/ 8 <161>;
        };
    };
...
```

## Documentation/devicetree/bindings/input/touchscreen/focaltech,ft8203-spi.yaml
```yaml
# SPDX-License-Identifier: (GPL-2.0-only OR BSD-2-Clause)
%YAML 1.2
---
$id: http://devicetree.org/schemas/input/touchscreen/focaltech,ft8203-spi.yaml#
$schema: http://devicetree.org/meta-schemas/core.yaml#

title: FocalTech FT8203 touch controller on SPI

maintainers:
  - rafroad <rafan.second@gmail.com>

description:
  The touch part of the FocalTech FT8203 display driver (TDDI) of the
  Galaxy Tab S7 FE. Its firmware lives in RAM and is downloaded after each
  power-on of the panel.

allOf:
  - $ref: /schemas/spi/spi-peripheral-props.yaml#

properties:
  compatible:
    const: focaltech,ft8203-spi

  reg:
    maxItems: 1

required:
  - compatible
  - reg

unevaluatedProperties: false

examples:
  - |
    spi {
        #address-cells = <1>;
        #size-cells = <0>;

        touch@0 {
            compatible = "focaltech,ft8203-spi";
            reg = <0>;
            spi-max-frequency = <6000000>;
        };
    };
...
```
