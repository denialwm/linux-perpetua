## Documentation/devicetree/bindings/media/i2c/samsung,s5kgnj.yaml
```yaml
# SPDX-License-Identifier: (GPL-2.0-only OR BSD-2-Clause)
%YAML 1.2
---
$id: http://devicetree.org/schemas/media/i2c/samsung,s5kgnj.yaml#
$schema: http://devicetree.org/meta-schemas/core.yaml#

title: Samsung S5KGNJ Image Sensor

description:
  Samsung S5KGNJ (ISOCELL GNJ) is a 50MP image sensor. The sensor is
  controlled over a serial camera control bus protocol, the widest output
  image frame size is 8192x6144 at 15 frames per second, data output
  format is RAW10 transferred over a 3-trio MIPI C-PHY interface.

maintainers:
  - Doctor Logix <doctor.logix@gmail.com>

allOf:
  - $ref: /schemas/media/video-interface-devices.yaml#

properties:
  compatible:
    const: samsung,s5kgnj

  reg:
    maxItems: 1

  clocks:
    description: MCLK supply clock.
    maxItems: 1

  reset-gpios:
    description: Active low GPIO connected to RESET pad of the sensor.
    maxItems: 1

  power-domains:
    description: The domain its clock comes from, where it is gated.
    maxItems: 1

  vdda-supply:
    description: Analogue voltage supply.

  vdda2-supply:
    description:
      Second module supply, 2.33 volts, enabled after the I/O supply. The
      sensor answers without it, but stops when it starts its internal
      firmware.

  vddd-supply:
    description: Digital core voltage supply.

  vddio-supply:
    description: Digital I/O voltage supply, 1.8 volts.

  port:
    $ref: /schemas/graph.yaml#/$defs/port-base
    additionalProperties: false

    properties:
      endpoint:
        $ref: /schemas/media/video-interfaces.yaml#
        unevaluatedProperties: false

        properties:
          bus-type:
            const: 1 # MEDIA_BUS_TYPE_CSI2_CPHY

          data-lanes:
            minItems: 3
            maxItems: 3

        required:
          - bus-type
          - data-lanes
          - link-frequencies

required:
  - compatible
  - reg
  - clocks
  - reset-gpios
  - vdda-supply
  - vdda2-supply
  - vddd-supply
  - vddio-supply
  - port

unevaluatedProperties: false

examples:
  - |
      #include <dt-bindings/gpio/gpio.h>
      #include <dt-bindings/media/video-interfaces.h>

      i2c {
          #address-cells = <1>;
          #size-cells = <0>;

          camera@10 {
              compatible = "samsung,s5kgnj";
              reg = <0x10>;
              clocks = <&camera_mclk 1>;
              assigned-clocks = <&camera_mclk 1>;
              assigned-clock-rates = <24000000>;
              reset-gpios = <&gpio1 10 GPIO_ACTIVE_LOW>;
              vdda-supply = <&vreg_2p2>;
              vdda2-supply = <&vreg_2p33>;
              vddd-supply = <&vreg_1p0>;
              vddio-supply = <&vreg_1p8>;

              port {
                  endpoint {
                      bus-type = <MEDIA_BUS_TYPE_CSI2_CPHY>;
                      data-lanes = <0 1 2>;
                      link-frequencies = /bits/ 64 <1428420000>;
                      remote-endpoint = <&csiphy_ep>;
                  };
              };
          };
      };
...
```

## Documentation/devicetree/bindings/media/i2c/smartsens,c658.yaml
```yaml
# SPDX-License-Identifier: (GPL-2.0-only OR BSD-2-Clause)
%YAML 1.2
---
$id: http://devicetree.org/schemas/media/i2c/smartsens,c658.yaml#
$schema: http://devicetree.org/meta-schemas/core.yaml#

title: SmartSens C658 and D154 CMOS image sensors

maintainers:
  - Travis Geisinger <travis@geisinger.dev>

description:
  The C658 (13 MP) and D154 (8 MP) are SmartSens raw Bayer image sensors
  with a four-lane MIPI CSI-2 D-PHY output, controlled over I2C. Both
  identify themselves by register 0x3107 and run from a 19.2 MHz clock.

allOf:
  - $ref: /schemas/media/video-interface-devices.yaml#

properties:
  compatible:
    enum:
      - smartsens,c658
      - smartsens,d154

  reg:
    maxItems: 1

  clocks:
    maxItems: 1

  power-domains:
    maxItems: 1
    description:
      Power domain the sensor clock input depends on, where the SoC drives
      the clock pad from a switchable domain.

  avdd-supply:
    description: Analogue circuit voltage supply.

  dovdd-supply:
    description: I/O circuit voltage supply.

  dvdd-supply:
    description: Digital core voltage supply.

  reset-gpios:
    maxItems: 1
    description: Active low GPIO connected to the reset pad of the sensor.

  port:
    $ref: /schemas/graph.yaml#/$defs/port-base
    additionalProperties: false

    properties:
      endpoint:
        $ref: /schemas/media/video-interfaces.yaml#
        additionalProperties: false

        properties:
          data-lanes:
            items:
              - const: 1
              - const: 2
              - const: 3
              - const: 4
          link-frequencies: true
          remote-endpoint: true

        required:
          - data-lanes
          - link-frequencies
          - remote-endpoint

required:
  - compatible
  - reg
  - clocks
  - avdd-supply
  - dovdd-supply
  - dvdd-supply
  - port

unevaluatedProperties: false

examples:
  - |
    #include <dt-bindings/gpio/gpio.h>

    i2c {
        #address-cells = <1>;
        #size-cells = <0>;

        camera@10 {
            compatible = "smartsens,d154";
            reg = <0x10>;

            clocks = <&cam_mclk4>;
            assigned-clocks = <&cam_mclk4>;
            assigned-clock-rates = <19200000>;

            reset-gpios = <&tlmm 7 GPIO_ACTIVE_LOW>;

            avdd-supply = <&vreg_cam_2p8>;
            dovdd-supply = <&vreg_cam_1p8>;
            dvdd-supply = <&vreg_cam_1p2>;

            orientation = <0>;
            rotation = <0>;

            port {
                endpoint {
                    data-lanes = <1 2 3 4>;
                    link-frequencies = /bits/ 64 <330000000>;
                    remote-endpoint = <&csiphy5_in_ep>;
                };
            };
        };
    };
...
```

## Documentation/devicetree/bindings/media/qcom,eliza-camss.yaml
```yaml
# SPDX-License-Identifier: (GPL-2.0 OR BSD-2-Clause)
%YAML 1.2
---
$id: http://devicetree.org/schemas/media/qcom,eliza-camss.yaml#
$schema: http://devicetree.org/meta-schemas/core.yaml#

title: Qualcomm Eliza Camera Subsystem (CAMSS)

maintainers:
  - Doctor Logix <doctor.logix@gmail.com>

description:
  The CAMSS IP is a CSI decoder and ISP present on Qualcomm platforms. On
  Eliza this describes the four CSIPHYs and the lite path, one CSID lite and
  one VFE lite, which writes raw frames to memory.

properties:
  compatible:
    const: qcom,eliza-camss

  reg:
    maxItems: 6

  reg-names:
    items:
      - const: csid_lite0
      - const: csiphy0
      - const: csiphy1
      - const: csiphy2
      - const: csiphy3
      - const: vfe_lite0

  clocks:
    maxItems: 19

  clock-names:
    items:
      - const: camnoc_nrt_axi
      - const: camnoc_rt_axi
      - const: cpas_ahb
      - const: cpas_fast_ahb
      - const: cpas_vfe_lite
      - const: csiphy0
      - const: csiphy0_timer
      - const: csiphy1
      - const: csiphy1_timer
      - const: csiphy2
      - const: csiphy2_timer
      - const: csiphy3
      - const: csiphy3_timer
      - const: gcc_axi_hf
      - const: vfe_lite
      - const: vfe_lite_ahb
      - const: vfe_lite_cphy_rx
      - const: vfe_lite_csid
      - const: qdss_debug_xo

  interrupts:
    maxItems: 6

  interrupt-names:
    items:
      - const: csid_lite0
      - const: csiphy0
      - const: csiphy1
      - const: csiphy2
      - const: csiphy3
      - const: vfe_lite0

  interconnects:
    maxItems: 2

  interconnect-names:
    items:
      - const: ahb
      - const: hf_mnoc

  iommus:
    maxItems: 1

  power-domains:
    items:
      - description: Titan GDSC - Titan ISP Block, Global Distributed Switch Controller.

  power-domain-names:
    items:
      - const: top

  vdd-csiphy-0p9-supply:
    description:
      Phandle to a 0.9V regulator supply to the CSIPHY IP blocks.

  vdd-csiphy-1p2-supply:
    description:
      Phandle to a 1.2V regulator supply to the CSIPHY IP blocks.

  ports:
    $ref: /schemas/graph.yaml#/properties/ports

    description:
      CSI input ports.

    patternProperties:
      "^port@[0-3]$":
        $ref: /schemas/graph.yaml#/$defs/port-base
        unevaluatedProperties: false

        description:
          Input port for receiving CSI data from a CSIPHY.

        properties:
          endpoint:
            $ref: video-interfaces.yaml#
            unevaluatedProperties: false

            properties:
              data-lanes:
                minItems: 1
                maxItems: 4

              bus-type:
                const: 4 # MEDIA_BUS_TYPE_CSI2_DPHY

            required:
              - data-lanes

required:
  - compatible
  - reg
  - reg-names
  - clocks
  - clock-names
  - interconnects
  - interconnect-names
  - interrupts
  - interrupt-names
  - iommus
  - power-domains
  - power-domain-names

additionalProperties: false

examples:
  - |
    #include <dt-bindings/clock/qcom,eliza-camcc.h>
    #include <dt-bindings/clock/qcom,eliza-gcc.h>
    #include <dt-bindings/interconnect/qcom,eliza-rpmh.h>
    #include <dt-bindings/interrupt-controller/arm-gic.h>
    #include <dt-bindings/media/video-interfaces.h>

    soc {
        #address-cells = <2>;
        #size-cells = <2>;

        isp@ad6d000 {
            compatible = "qcom,eliza-camss";

            reg = <0x0 0x0ad6d000 0x0 0xa00>,
                  <0x0 0x0ada9000 0x0 0x2000>,
                  <0x0 0x0adab000 0x0 0x2000>,
                  <0x0 0x0adad000 0x0 0x2000>,
                  <0x0 0x0adaf000 0x0 0x2000>,
                  <0x0 0x0ad6e000 0x0 0x1800>;
            reg-names = "csid_lite0",
                        "csiphy0",
                        "csiphy1",
                        "csiphy2",
                        "csiphy3",
                        "vfe_lite0";

            clocks = <&camcc CAM_CC_CAMNOC_NRT_AXI_CLK>,
                     <&camcc CAM_CC_CAMNOC_RT_AXI_CLK>,
                     <&camcc CAM_CC_CAM_TOP_AHB_CLK>,
                     <&camcc CAM_CC_CAM_TOP_FAST_AHB_CLK>,
                     <&camcc CAM_CC_CAMNOC_RT_IFE_LITE_CLK>,
                     <&camcc CAM_CC_CSIPHY0_CLK>,
                     <&camcc CAM_CC_CSI0PHYTIMER_CLK>,
                     <&camcc CAM_CC_CSIPHY1_CLK>,
                     <&camcc CAM_CC_CSI1PHYTIMER_CLK>,
                     <&camcc CAM_CC_CSIPHY2_CLK>,
                     <&camcc CAM_CC_CSI2PHYTIMER_CLK>,
                     <&camcc CAM_CC_CSIPHY3_CLK>,
                     <&camcc CAM_CC_CSI3PHYTIMER_CLK>,
                     <&gcc GCC_CAMERA_HF_AXI_CLK>,
                     <&camcc CAM_CC_IFE_LITE_CLK>,
                     <&camcc CAM_CC_IFE_LITE_AHB_CLK>,
                     <&camcc CAM_CC_IFE_LITE_CPHY_RX_CLK>,
                     <&camcc CAM_CC_IFE_LITE_CSID_CLK>,
                     <&camcc CAM_CC_QDSS_DEBUG_XO_CLK>;
            clock-names = "camnoc_nrt_axi",
                          "camnoc_rt_axi",
                          "cpas_ahb",
                          "cpas_fast_ahb",
                          "cpas_vfe_lite",
                          "csiphy0",
                          "csiphy0_timer",
                          "csiphy1",
                          "csiphy1_timer",
                          "csiphy2",
                          "csiphy2_timer",
                          "csiphy3",
                          "csiphy3_timer",
                          "gcc_axi_hf",
                          "vfe_lite",
                          "vfe_lite_ahb",
                          "vfe_lite_cphy_rx",
                          "vfe_lite_csid",
                          "qdss_debug_xo";

            interrupts = <GIC_SPI 605 IRQ_TYPE_EDGE_RISING>,
                         <GIC_SPI 568 IRQ_TYPE_EDGE_RISING>,
                         <GIC_SPI 569 IRQ_TYPE_EDGE_RISING>,
                         <GIC_SPI 570 IRQ_TYPE_EDGE_RISING>,
                         <GIC_SPI 571 IRQ_TYPE_EDGE_RISING>,
                         <GIC_SPI 606 IRQ_TYPE_EDGE_RISING>;
            interrupt-names = "csid_lite0",
                              "csiphy0",
                              "csiphy1",
                              "csiphy2",
                              "csiphy3",
                              "vfe_lite0";

            interconnects = <&gem_noc MASTER_APPSS_PROC 0 &config_noc SLAVE_CAMERA_CFG 0>,
                            <&mmss_noc MASTER_CAMNOC_HF 0 &mc_virt SLAVE_EBI1 0>;
            interconnect-names = "ahb",
                                 "hf_mnoc";

            iommus = <&apps_smmu 0x1c00 0x0>;

            power-domains = <&camcc CAM_CC_TITAN_TOP_GDSC>;
            power-domain-names = "top";

            vdd-csiphy-0p9-supply = <&vreg_csiphy_0p9>;
            vdd-csiphy-1p2-supply = <&vreg_csiphy_1p2>;

            ports {
                #address-cells = <1>;
                #size-cells = <0>;

                port@1 {
                    reg = <1>;

                    csiphy1_ep: endpoint {
                        data-lanes = <0 1 2 3>;
                        bus-type = <MEDIA_BUS_TYPE_CSI2_DPHY>;
                        remote-endpoint = <&sensor_ep>;
                    };
                };
            };
        };
    };
```

## Documentation/devicetree/bindings/memory-controllers/google,gs101-mif.yaml
```yaml
# SPDX-License-Identifier: (GPL-2.0-only OR BSD-2-Clause)
%YAML 1.2
---
$id: http://devicetree.org/schemas/memory-controllers/google,gs101-mif.yaml#
$schema: http://devicetree.org/meta-schemas/core.yaml#

title: Google gs101 memory interface (MIF) frequency scaling

maintainers:
  - Noswad <64293615+TheNoswad@users.noreply.github.com>

description:
  The memory interface (MIF) of the Google gs101 SoC clocks the DRAM
  controllers and the memory bus. Its rate is one of the ACPM firmware's
  DVFS domains; the firmware sets the voltage that goes with each rate.

properties:
  compatible:
    const: google,gs101-mif

  clocks:
    items:
      - description: The ACPM DVFS clock of the MIF domain.

  operating-points-v2: true
  opp-table:
    type: object

required:
  - compatible
  - clocks
  - operating-points-v2

additionalProperties: false

examples:
  - |
    #include <dt-bindings/clock/google,gs101-acpm.h>

    mif {
        compatible = "google,gs101-mif";
        clocks = <&acpm_ipc GS101_CLK_ACPM_DVFS_MIF>;
        operating-points-v2 = <&mif_opp_table>;
    };

    mif_opp_table: opp-table-mif {
        compatible = "operating-points-v2";

        opp-421000000 {
            opp-hz = /bits/ 64 <421000000>;
        };

        opp-3172000000 {
            opp-hz = /bits/ 64 <3172000000>;
        };
    };
```
