## Documentation/devicetree/bindings/display/msm/dpu-common.yaml
```yaml
%YAML 1.2
---
$id: http://devicetree.org/schemas/display/msm/dpu-common.yaml#
$schema: http://devicetree.org/meta-schemas/core.yaml#

title: Qualcomm Display DPU common properties

maintainers:
  - Krishna Manikandan <quic_mkrishn@quicinc.com>
  - Dmitry Baryshkov <dmitry.baryshkov@linaro.org>
  - Rob Clark <robdclark@gmail.com>

description: |
  Common properties for QCom DPU display controller.

# Do not select this by default, otherwise it is also selected for all
# display-controller@ nodes
select:
  false

properties:
  $nodename:
    pattern: '^display-controller@[0-9a-f]+$'

  interrupts:
    maxItems: 1

  power-domains:
    maxItems: 1

  operating-points-v2: true
  opp-table:
    type: object

  qcom,dpu-disable-multirect:
    description: |
      Disable the pairing of a mixer pair's two plane pipes into one
      source pipe (SSPP multi-rect). Displays whose high refresh rate
      needs one source pipe per mixer (the quad-pipe topology) set this:
      the stock kernel runs those modes without the pairing, and the
      panel can garble on the paired topology.
    type: boolean

  ports:
    $ref: /schemas/graph.yaml#/properties/ports
    description: |
      Contains the list of output ports from DPU device. These ports
      connect to interfaces that are external to the DPU hardware,
      such as DSI, DP etc.

    patternProperties:
      "^port@[0-9a-f]+$":
        $ref: /schemas/graph.yaml#/properties/port

    # at least one port is required
    required:
      - port@0

required:
  - interrupts
  - power-domains
  - operating-points-v2
  - ports

additionalProperties: true
```

## Documentation/devicetree/bindings/display/panel/boe,ts124qdm.yaml
```yaml
# SPDX-License-Identifier: GPL-2.0-only OR BSD-2-Clause
%YAML 1.2
---
$id: http://devicetree.org/schemas/display/panel/boe,ts124qdm.yaml#
$schema: http://devicetree.org/meta-schemas/core.yaml#

title: BOE TS124QDM DSI panel

maintainers:
  - rafroad <rafan.second@gmail.com>

description:
  The 12.4" 1600x2560 LCD of the Samsung Galaxy Tab S7 FE, on a FocalTech
  FT8203 touch and display controller, in video mode with DSC. Its other
  supplies are left to the bootloader for now.

allOf:
  - $ref: panel-common.yaml#

properties:
  compatible:
    const: boe,ts124qdm

  reg:
    maxItems: 1
    description: DSI virtual channel

  port: true
  reset-gpios: true

  boost-supply:
    description: 5 V backlight boost; switched off before the panel stops

required:
  - compatible
  - reg
  - port
  - reset-gpios
  - boost-supply

additionalProperties: false

examples:
  - |
    #include <dt-bindings/gpio/gpio.h>

    dsi {
        #address-cells = <1>;
        #size-cells = <0>;

        panel@0 {
            compatible = "boe,ts124qdm";
            reg = <0>;

            reset-gpios = <&tlmm 73 GPIO_ACTIVE_LOW>;
            boost-supply = <&backlight_boost>;

            port {
                endpoint {
                    remote-endpoint = <&mdss_dsi0_out>;
                };
            };
        };
    };
...
```

## Documentation/devicetree/bindings/display/panel/oneplus,erhai-nt36536.yaml
```yaml
# SPDX-License-Identifier: GPL-2.0-only OR BSD-2-Clause
%YAML 1.2
---
$id: http://devicetree.org/schemas/display/panel/oneplus,erhai-nt36536.yaml#
$schema: http://devicetree.org/meta-schemas/core.yaml#

title: OnePlus Pad 3 NT36536 LCD panel

maintainers:
  - Travis Geisinger <travis@geisinger.dev>

description:
  The 3392x2400 LCD panel of the OnePlus Pad 3 (erhai), which OnePlus names
  XN242. Its Novatek NT36536 controller takes two DSI links of four lanes,
  1696 pixels each, in video mode with DSC 1.2 at 8 bits per component. The
  touchscreen is part of the same controller and is reset with the panel.
  Its LCD bias comes from the backlight controller.

allOf:
  - $ref: panel-common-dual.yaml#

properties:
  compatible:
    items:
      - const: oneplus,erhai-nt36536
      - const: novatek,nt36536

  reg:
    maxItems: 1
    description: DSI virtual channel

  reset-gpios:
    maxItems: 1

  error-flag-gpios:
    description:
      The error flags of the controller, one per DSI link, which it raises
      when it detected an error and its picture may be lost, for example
      after an electrostatic discharge. The panel then needs a reset and
      its setup again.
    maxItems: 2

  vddio-supply:
    description: I/O voltage rail, 1.9 V on the OnePlus Pad 3

  avdd-supply:
    description: Positive LCD bias

  avee-supply:
    description: Negative LCD bias

  pinctrl-0: true
  pinctrl-1: true
  pinctrl-names:
    items:
      - const: default
      - const: sleep

  backlight: true
  ports: true

required:
  - compatible
  - reg
  - reset-gpios
  - ports

additionalProperties: false

examples:
  - |
    #include <dt-bindings/gpio/gpio.h>

    dsi {
        #address-cells = <1>;
        #size-cells = <0>;

        panel@0 {
            compatible = "oneplus,erhai-nt36536";
            reg = <0>;

            reset-gpios = <&tlmm 98 GPIO_ACTIVE_LOW>;
            error-flag-gpios = <&tlmm 86 GPIO_ACTIVE_HIGH>,
                               <&tlmm 87 GPIO_ACTIVE_HIGH>;
            backlight = <&backlight>;

            ports {
                #address-cells = <1>;
                #size-cells = <0>;

                port@0 {
                    reg = <0>;

                    panel_in_0: endpoint {
                        remote-endpoint = <&dsi0_out>;
                    };
                };

                port@1 {
                    reg = <1>;

                    panel_in_1: endpoint {
                        remote-endpoint = <&dsi1_out>;
                    };
                };
            };
        };
    };
...
```

## Documentation/devicetree/bindings/display/panel/samsung,s6e3fc3.yaml
```yaml
# SPDX-License-Identifier: (GPL-2.0-only OR BSD-2-Clause)
%YAML 1.2
---
$id: http://devicetree.org/schemas/display/panel/samsung,s6e3fc3.yaml#
$schema: http://devicetree.org/meta-schemas/core.yaml#

title: Samsung S6E3FC3 AMOLED DDIC

maintainers:
  - Noswad <64293615+TheNoswad@users.noreply.github.com>

description:
  The S6E3FC3 is a display driver IC with a connected 1080x2400 AMOLED
  panel, driven in DSI command mode, as fitted to the Google Pixel 6.

allOf:
  - $ref: panel-common.yaml#

properties:
  compatible:
    const: samsung,s6e3fc3

  reg:
    maxItems: 1

  vci-supply:
    description: VCI (analog) supply

  vddi-supply:
    description: VDDI (logic and I/O) supply

required:
  - compatible
  - reg
  - reset-gpios
  - vci-supply
  - vddi-supply

unevaluatedProperties: false

examples:
  - |
    #include <dt-bindings/gpio/gpio.h>

    dsi {
        #address-cells = <1>;
        #size-cells = <0>;

        panel@0 {
            compatible = "samsung,s6e3fc3";
            reg = <0>;
            reset-gpios = <&gpp24 1 GPIO_ACTIVE_LOW>;
            vci-supply = <&vci_disp>;
            vddi-supply = <&vddi_disp>;
        };
    };
```

## Documentation/devicetree/bindings/display/panel/visionox,nt37705.yaml
```yaml
# SPDX-License-Identifier: GPL-2.0-only OR BSD-2-Clause
%YAML 1.2
---
$id: http://devicetree.org/schemas/display/panel/visionox,nt37705.yaml#
$schema: http://devicetree.org/meta-schemas/core.yaml#

title: Visionox NT37705 1080x2412 120Hz MIPI-DSI Panel

maintainers:
  - Simayon <simayonthampi@gmail.com>

description:
  The Visionox NT37705 is a DSI panel controller for AMOLED panels. It is
  driven in command mode, with Display Stream Compression, at 1080x2412 and
  up to 120 Hz.

allOf:
  - $ref: panel-common.yaml#

properties:
  compatible:
    const: visionox,nt37705

  reg:
    maxItems: 1

  reset-gpios: true

  vdd-supply:
    description: 1.8V logic supply

  vci-supply:
    description: Analog supply of the panel

  vddio-supply:
    description: I/O supply

  port: true

required:
  - compatible
  - reg
  - reset-gpios
  - vdd-supply
  - vci-supply
  - vddio-supply
  - port

unevaluatedProperties: false

examples:
  - |
    #include <dt-bindings/gpio/gpio.h>

    dsi {
        #address-cells = <1>;
        #size-cells = <0>;

        panel@0 {
            compatible = "visionox,nt37705";
            reg = <0>;

            reset-gpios = <&tlmm 0 GPIO_ACTIVE_LOW>;

            vdd-supply = <&vreg_l1>;
            vci-supply = <&vreg_l2>;
            vddio-supply = <&vreg_l3>;

            port {
                panel_in: endpoint {
                    remote-endpoint = <&dsi0_out>;
                };
            };
        };
    };
...
```

## Documentation/devicetree/bindings/display/samsung/google,gs101-decon.yaml
```yaml
# SPDX-License-Identifier: (GPL-2.0-only OR BSD-2-Clause)
%YAML 1.2
---
$id: http://devicetree.org/schemas/display/samsung/google,gs101-decon.yaml#
$schema: http://devicetree.org/meta-schemas/core.yaml#

title: Google gs101 Display and Enhancement Controller (DECON)

maintainers:
  - Noswad <64293615+TheNoswad@users.noreply.github.com>

description: |
  DECON is the display controller of the gs101 Display Processing Unit
  (DPU). It blends up to six windows, each fed by one DPP (Display
  Pre-Processor) DMA channel, and sends the result to a DSI interface. With
  a command-mode panel it transfers each frame on the panel's tearing
  effect (TE) signal through its hardware trigger.

  DECON0 owns its main and window control banks; the window and sub banks
  are shared with the other DECONs.

properties:
  compatible:
    const: google,gs101-decon

  reg:
    items:
      - description: main control bank of this DECON
      - description: window configuration, shared between DECONs
      - description: sub block (DSC, DSIM and DP interfaces), shared
      - description: window control bank of this DECON

  reg-names:
    items:
      - const: main
      - const: win
      - const: sub
      - const: wincon

  interrupts:
    items:
      - description: frame start
      - description: frame done
      - description: extra (errors and resource conflicts)

  interrupt-names:
    items:
      - const: frame-start
      - const: frame-done
      - const: extra

  clocks:
    items:
      - description: DPU APB clock
      - description: DPU peripheral bus clock
      - description: DPU data bus clock

  clock-names:
    items:
      - const: pclk
      - const: busp
      - const: busd

  google,dpps:
    $ref: /schemas/types.yaml#/definitions/phandle-array
    description:
      The DPP channels this DECON can blend, in channel order.
    minItems: 1
    maxItems: 6
    items:
      maxItems: 1

  port:
    $ref: /schemas/graph.yaml#/properties/port
    description: Output to the DSI host.

required:
  - compatible
  - reg
  - reg-names
  - interrupts
  - interrupt-names
  - clocks
  - clock-names
  - google,dpps
  - port

additionalProperties: false

examples:
  - |
    #include <dt-bindings/clock/google,gs101.h>
    #include <dt-bindings/interrupt-controller/arm-gic.h>

    display-controller@1c300000 {
        compatible = "google,gs101-decon";
        reg = <0x1c300000 0x6000>, <0x1c310000 0x6000>,
              <0x1c320000 0x10000>, <0x1c330000 0x6000>;
        reg-names = "main", "win", "sub", "wincon";
        interrupts = <GIC_SPI 338 IRQ_TYPE_LEVEL_HIGH>,
                     <GIC_SPI 337 IRQ_TYPE_LEVEL_HIGH>,
                     <GIC_SPI 336 IRQ_TYPE_LEVEL_HIGH>;
        interrupt-names = "frame-start", "frame-done", "extra";
        clocks = <&cmu_dpu CLK_GOUT_DPU_PCLK>,
                 <&cmu_dpu CLK_GOUT_DPU_CLK_DPU_BUSP_CLK>,
                 <&cmu_dpu CLK_GOUT_DPU_CLK_DPU_BUSD_CLK>;
        clock-names = "pclk", "busp", "busd";
        google,dpps = <&dpp0>;

        port {
            decon0_out: endpoint {
                remote-endpoint = <&dsim0_in>;
            };
        };
    };
```

## Documentation/devicetree/bindings/display/samsung/google,gs101-dpp.yaml
```yaml
# SPDX-License-Identifier: (GPL-2.0-only OR BSD-2-Clause)
%YAML 1.2
---
$id: http://devicetree.org/schemas/display/samsung/google,gs101-dpp.yaml#
$schema: http://devicetree.org/meta-schemas/core.yaml#

title: Google gs101 Display Pre-Processor (DPP)

maintainers:
  - Noswad <64293615+TheNoswad@users.noreply.github.com>

description: |
  A DPP channel of the gs101 Display Processing Unit fetches one image
  layer from memory (its DMA bank), converts it (its DPP bank) and feeds a
  window of a DECON. gs101 has six channels, L0 to L5.

properties:
  compatible:
    const: google,gs101-dpp

  reg:
    items:
      - description: DMA (fetch) bank
      - description: DPP (processing) bank

  reg-names:
    items:
      - const: dma
      - const: dpp

  interrupts:
    items:
      - description: DMA interrupt
      - description: DPP interrupt

  interrupt-names:
    items:
      - const: dma
      - const: dpp

  clocks:
    items:
      - description: DPU APB clock
      - description: DPU peripheral bus clock
      - description: DPU fetch DMA clock
      - description: DPU pixel pipeline clock

  clock-names:
    items:
      - const: pclk
      - const: busp
      - const: aclk_dma
      - const: aclk_dpp

required:
  - compatible
  - reg
  - reg-names
  - interrupts
  - interrupt-names
  - clocks
  - clock-names

additionalProperties: false

examples:
  - |
    #include <dt-bindings/clock/google,gs101.h>
    #include <dt-bindings/interrupt-controller/arm-gic.h>

    dpp@1c0b0000 {
        compatible = "google,gs101-dpp";
        reg = <0x1c0b0000 0x1000>, <0x1c0d0000 0x1000>;
        reg-names = "dma", "dpp";
        interrupts = <GIC_SPI 354 IRQ_TYPE_LEVEL_HIGH>,
                     <GIC_SPI 361 IRQ_TYPE_LEVEL_HIGH>;
        interrupt-names = "dma", "dpp";
        clocks = <&cmu_dpu CLK_GOUT_DPU_PCLK>,
                 <&cmu_dpu CLK_GOUT_DPU_CLK_DPU_BUSP_CLK>,
                 <&cmu_dpu CLK_GOUT_DPU_DPUF_ACLK_DMA>,
                 <&cmu_dpu CLK_GOUT_DPU_DPUF_ACLK_DPP>;
        clock-names = "pclk", "busp", "aclk_dma", "aclk_dpp";
    };
```

## Documentation/devicetree/bindings/display/samsung/google,gs101-dsim.yaml
```yaml
# SPDX-License-Identifier: (GPL-2.0-only OR BSD-2-Clause)
%YAML 1.2
---
$id: http://devicetree.org/schemas/display/samsung/google,gs101-dsim.yaml#
$schema: http://devicetree.org/meta-schemas/core.yaml#

title: Google gs101 MIPI DSI host (DSIM)

maintainers:
  - Noswad <64293615+TheNoswad@users.noreply.github.com>

description: |
  The DSIM of the gs101 Display Processing Unit is the MIPI DSI host that
  carries DECON's output and the DCS commands to a panel. Its D-PHY is a
  separate block.

allOf:
  - $ref: /schemas/display/dsi-controller.yaml#

properties:
  compatible:
    const: google,gs101-dsim

  reg:
    maxItems: 1

  interrupts:
    maxItems: 1

  clocks:
    items:
      - description: DPU APB clock
      - description: DPU peripheral bus clock

  clock-names:
    items:
      - const: pclk
      - const: busp

  port:
    $ref: /schemas/graph.yaml#/properties/port
    description: Input from DECON.

required:
  - compatible
  - reg
  - interrupts
  - clocks
  - clock-names
  - port

unevaluatedProperties: false

examples:
  - |
    #include <dt-bindings/clock/google,gs101.h>
    #include <dt-bindings/gpio/gpio.h>
    #include <dt-bindings/interrupt-controller/arm-gic.h>

    dsi@1c2c0000 {
        compatible = "google,gs101-dsim";
        reg = <0x1c2c0000 0x300>;
        interrupts = <GIC_SPI 345 IRQ_TYPE_LEVEL_HIGH>;
        clocks = <&cmu_dpu CLK_GOUT_DPU_PCLK>,
                 <&cmu_dpu CLK_GOUT_DPU_CLK_DPU_BUSP_CLK>;
        clock-names = "pclk", "busp";
        #address-cells = <1>;
        #size-cells = <0>;

        port {
            dsim0_in: endpoint {
                remote-endpoint = <&decon0_out>;
            };
        };

        panel@0 {
            compatible = "samsung,s6e3fc3";
            reg = <0>;
            reset-gpios = <&gpp24 1 GPIO_ACTIVE_LOW>;
            vci-supply = <&vci_disp>;
            vddi-supply = <&vddi_disp>;
        };
    };
```
