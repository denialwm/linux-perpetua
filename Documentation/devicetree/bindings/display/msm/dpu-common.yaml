## Documentation/devicetree/bindings/input/touchscreen/novatek,nvt-ts-spi.yaml
```yaml
# SPDX-License-Identifier: (GPL-2.0-only OR BSD-2-Clause)
%YAML 1.2
---
$id: http://devicetree.org/schemas/input/touchscreen/novatek,nvt-ts-spi.yaml#
$schema: http://devicetree.org/meta-schemas/core.yaml#

title: Novatek NT365xx SPI touch controller

maintainers:
  - Travis Geisinger <travis@geisinger.dev>

description:
  The touch side of a Novatek NT36532 or NT36536 display and touch driver IC
  (TDDI), on SPI. The controller has no flash and takes its firmware from the
  host each time the panel powers it up, so it runs while the panel does. It
  can also sense an active stylus.

allOf:
  - $ref: touchscreen.yaml#
  - $ref: /schemas/spi/spi-peripheral-props.yaml#

properties:
  compatible:
    const: novatek,NVT-ts-spi

  reg:
    maxItems: 1

  irq-gpios:
    maxItems: 1
    description: The interrupt line, read as a GPIO.

  reset-gpios:
    maxItems: 1
    description: The reset line, on boards where the host drives it.

  panel:
    $ref: /schemas/types.yaml#/definitions/phandle
    description: The display panel the controller is part of.

  firmware-name:
    maxItems: 1
    description: The firmware file to load into the controller.

  novatek,pen-support:
    type: boolean
    description: An active stylus is used with the panel.

  novatek,pen-max-pressure:
    $ref: /schemas/types.yaml#/definitions/uint32
    default: 16384
    description: The highest stylus pressure the firmware reports.

  novatek,pen-type:
    $ref: /schemas/types.yaml#/definitions/uint32
    enum: [1, 2, 3, 4, 5]
    description: |
      The active stylus the firmware is to sense, as the panel vendor numbers
      them. The firmware takes a command for each:

        1  the default stylus, command 0x7f 0x10
        2  0x7f 0x12
        3  0x7f 0x13
        4  0x7f 0x15
        5  0x7f 0x18

      When it is given, the host sends that command each time the firmware
      starts, and 0x7f 0x11, no stylus, while the display is off. Without
      it the firmware is left at its own default.

  novatek,spi-rd-fast-addr:
    $ref: /schemas/types.yaml#/definitions/uint32
    description: The address of the firmware's fast read window.

  wakeup-source: true

  pinctrl-0: true
  pinctrl-names: true

dependencies:
  novatek,pen-max-pressure: [ 'novatek,pen-support' ]
  novatek,pen-type: [ 'novatek,pen-support' ]

required:
  - compatible
  - reg
  - irq-gpios

unevaluatedProperties: false

examples:
  - |
    #include <dt-bindings/gpio/gpio.h>
    spi {
        #address-cells = <1>;
        #size-cells = <0>;

        touchscreen@0 {
            compatible = "novatek,NVT-ts-spi";
            reg = <0>;
            spi-max-frequency = <12000000>;
            irq-gpios = <&tlmm 162 GPIO_ACTIVE_HIGH>;
            novatek,pen-support;
            novatek,pen-max-pressure = <65532>;
            novatek,pen-type = <1>;
            panel = <&display_panel>;
            firmware-name = "novatek/erhai/novatek_nt36536_fw.bin";
            touchscreen-size-x = <24000>;
            touchscreen-size-y = <33920>;
            touchscreen-inverted-x;
            touchscreen-swapped-x-y;
            wakeup-source;
        };
    };
...
```

## Documentation/devicetree/bindings/input/touchscreen/st,fts-spi.yaml
```yaml
# SPDX-License-Identifier: (GPL-2.0-only OR BSD-2-Clause)
%YAML 1.2
---
$id: http://devicetree.org/schemas/input/touchscreen/st,fts-spi.yaml#
$schema: http://devicetree.org/meta-schemas/core.yaml#

title: STMicroelectronics FingerTipS SPI touchscreen controller

description: |
  The FingerTipS controller sits on an SPI bus and reports multitouch events
  through an interrupt line. The controller firmware is loaded by the
  bootloader; the driver resets the controller, reads its SYS_INFO and runs
  the panel initialization the firmware expects.

maintainers:
  - Bronson <bronsonmathews@gmail.com>

allOf:
  - $ref: touchscreen.yaml#
  - $ref: /schemas/spi/spi-peripheral-props.yaml#

properties:
  compatible:
    const: st,fts-spi

  reg:
    maxItems: 1

  interrupts:
    maxItems: 1

  reset-gpios:
    maxItems: 1
    description: Reset line of the controller.

  lpi2ap-gpios:
    maxItems: 1
    description: Line that hands the bus from the low-power island to the AP.

  ap2lpi-gpios:
    maxItems: 1
    description: Line that hands the bus from the AP to the low-power island.

  vdd-supply:
    description: Power supply of the controller.

  st,panel_map:
    $ref: /schemas/types.yaml#/definitions/phandle-array
    description: |
      Phandle to the panel this touchscreen is paired with and the panel
      index assigned to it.
    items:
      - items:
          - description: phandle to the panel
          - description: panel index

  st,force-pi-cfg-ver-map:
    $ref: /schemas/types.yaml#/definitions/uint32-array
    description: |
      Configuration versions for which the driver runs a full panel
      initialization even when the AFE and panel configuration versions
      match.

  st,save-golden-ms-raw:
    type: boolean
    description: |
      Ask the controller to save its golden mutual-raw baseline after the
      panel initialization.

  st,max-coords:
    $ref: /schemas/types.yaml#/definitions/uint32-array
    minItems: 2
    maxItems: 2
    description: Maximum X and Y coordinates reported by the controller.

required:
  - compatible
  - reg
  - interrupts
  - vdd-supply

unevaluatedProperties: false

examples:
  - |
    #include <dt-bindings/gpio/gpio.h>
    #include <dt-bindings/interrupt-controller/irq.h>

    spi {
        #address-cells = <1>;
        #size-cells = <0>;

        touchscreen@0 {
            compatible = "st,fts-spi";
            reg = <0>;
            spi-max-frequency = <10000000>;
            interrupt-parent = <&tlmm>;
            interrupts = <9 IRQ_TYPE_LEVEL_LOW>;
            reset-gpios = <&tlmm 8 GPIO_ACTIVE_LOW>;
            ap2lpi-gpios = <&tlmm 35 GPIO_ACTIVE_HIGH>;
            lpi2ap-gpios = <&tlmm 5 GPIO_ACTIVE_HIGH>;
            vdd-supply = <&vreg_l13a_3p3>;
            touchscreen-size-x = <1080>;
            touchscreen-size-y = <2400>;
            st,max-coords = <1079 2399>;
            st,force-pi-cfg-ver-map = <0x300 0x306>;
            st,save-golden-ms-raw;
        };
    };
...
```

## Documentation/devicetree/bindings/input/touchscreen/wacom,w9021.yaml
```yaml
# SPDX-License-Identifier: (GPL-2.0-only OR BSD-2-Clause)
%YAML 1.2
---
$id: http://devicetree.org/schemas/input/touchscreen/wacom,w9021.yaml#
$schema: http://devicetree.org/meta-schemas/core.yaml#

title: Wacom W9021 EMR digitizer with Samsung firmware

maintainers:
  - rafroad <rafan.second@gmail.com>

description:
  The electromagnetic pen digitizer (S Pen) of the Galaxy Tab S7 FE, on
  I2C. Its firmware reports pen packets on a level-low interrupt.

allOf:
  - $ref: touchscreen.yaml#

properties:
  compatible:
    const: wacom,w9021

  reg:
    maxItems: 1

  interrupts:
    maxItems: 1

  vdd-supply:
    description: Analog supply of the digitizer.

  touchscreen-inverted-x: true
  touchscreen-inverted-y: true
  touchscreen-swapped-x-y: true

required:
  - compatible
  - reg
  - interrupts
  - vdd-supply

unevaluatedProperties: false

examples:
  - |
    #include <dt-bindings/interrupt-controller/irq.h>

    i2c {
        #address-cells = <1>;
        #size-cells = <0>;

        digitizer@56 {
            compatible = "wacom,w9021";
            reg = <0x56>;
            interrupts-extended = <&tlmm 85 IRQ_TYPE_LEVEL_LOW>;
            vdd-supply = <&vreg_l8a>;
            touchscreen-inverted-x;
            touchscreen-swapped-x-y;
        };
    };
...
```

## Documentation/devicetree/bindings/interconnect/qcom,sm7250-rpmh.yaml
```yaml
# SPDX-License-Identifier: (GPL-2.0-only OR BSD-2-Clause)
%YAML 1.2
---
$id: http://devicetree.org/schemas/interconnect/qcom,sm7250-rpmh.yaml#
$schema: http://devicetree.org/meta-schemas/core.yaml#

title: Qualcomm RPMh Network-On-Chip Interconnect on SM7250

maintainers:
  - Ishu Brar <patches@brar.si>

description: |
  RPMh interconnect providers support system bandwidth requirements through
  RPMh hardware accelerators known as Bus Clock Manager (BCM). The provider is
  able to communicate with the BCM through the Resource State Coordinator (RSC)
  associated with each execution environment. Provider nodes must point to at
  least one RPMh device child node pertaining to their RSC and each provider
  can map to multiple RPMh resources.

  See also: include/dt-bindings/interconnect/qcom,sm7250-rpmh.h

allOf:
  - $ref: qcom,rpmh-common.yaml#
  - if:
      properties:
        compatible:
          contains:
            const: qcom,sm7250-aggre1-noc
    then:
      required:
        - clocks
    else:
      properties:
        clocks: false

properties:
  compatible:
    enum:
      - qcom,sm7250-aggre1-noc
      - qcom,sm7250-aggre2-noc
      - qcom,sm7250-config-noc
      - qcom,sm7250-dc-noc
      - qcom,sm7250-gem-noc
      - qcom,sm7250-mmss-noc
      - qcom,sm7250-npu-noc
      - qcom,sm7250-system-noc

  reg:
    maxItems: 1

  clocks:
    items:
      - description: aggre UFS PHY AXI clock
      - description: aggre USB3 PRIM AXI clock

patternProperties:
  '^interconnect-[0-9]+$':
    type: object
    description:
      The interconnect providers do not have a separate QoS register space,
      but share parent's space.

    allOf:
      - $ref: qcom,rpmh-common.yaml#

    properties:
      compatible:
        enum:
          - qcom,sm7250-compute-noc
          - qcom,sm7250-mc-virt
          - qcom,sm7250-qup-virt

    required:
      - compatible

    unevaluatedProperties: false

required:
  - compatible
  - reg

unevaluatedProperties: false

examples:
  - |
    interconnect@16e0000 {
        compatible = "qcom,sm7250-aggre1-noc";
        reg = <0x016e0000 0x15080>;
        #interconnect-cells = <2>;
        clocks = <&gcc 4>, <&gcc 5>;
        qcom,bcm-voters = <&apps_bcm_voter>;
    };

    interconnect@1620000 {
        compatible = "qcom,sm7250-system-noc";
        reg = <0x01620000 0x19200>;
        #interconnect-cells = <2>;
        qcom,bcm-voters = <&apps_bcm_voter>;

        interconnect-0 {
            compatible = "qcom,sm7250-qup-virt";
            #interconnect-cells = <2>;
            qcom,bcm-voters = <&apps_bcm_voter>;
        };
    };
```

## Documentation/devicetree/bindings/leds/awinic,aw22127.yaml
```yaml
# SPDX-License-Identifier: (GPL-2.0-only OR BSD-2-Clause)
%YAML 1.2
---
$id: http://devicetree.org/schemas/leds/awinic,aw22127.yaml#
$schema: http://devicetree.org/meta-schemas/core.yaml#

title: Awinic AW22127 RGB LED driver

maintainers:
  - Doctor Logix <doctor.logix@gmail.com>

description: |
  The AW22127 drives an LED matrix through a small MCU that runs a program
  kept in the chip's own flash. The program runs up to three effect tasks
  side by side, each driving up to four units; every unit is one RGB LED.
  A unit is addressed by its task and its place in that task, as
  reg = task * 4 + unit.

properties:
  compatible:
    const: awinic,aw22127

  reg:
    maxItems: 1

  reset-gpios:
    maxItems: 1

  "#address-cells":
    const: 1

  "#size-cells":
    const: 0

patternProperties:
  "^multi-led@[0-9a-b]$":
    type: object
    $ref: leds-class-multicolor.yaml#
    unevaluatedProperties: false

    properties:
      reg:
        description: The effect task times four, plus the unit in that task.
        maximum: 11

    required:
      - reg

required:
  - compatible
  - reg
  - reset-gpios
  - "#address-cells"
  - "#size-cells"

additionalProperties: false

examples:
  - |
    #include <dt-bindings/gpio/gpio.h>
    #include <dt-bindings/leds/common.h>

    i2c {
        #address-cells = <1>;
        #size-cells = <0>;

        led-controller@6a {
            compatible = "awinic,aw22127";
            reg = <0x6a>;
            reset-gpios = <&gpio 13 GPIO_ACTIVE_LOW>;
            #address-cells = <1>;
            #size-cells = <0>;

            /* Task 0, unit 0 */
            multi-led@0 {
                reg = <0>;
                color = <LED_COLOR_ID_RGB>;
                function = "trigger-left";
            };

            /* Task 2, unit 0 */
            multi-led@8 {
                reg = <8>;
                color = <LED_COLOR_ID_RGB>;
                function = "logo";
            };
        };
    };
```

## Documentation/devicetree/bindings/leds/backlight/kinetic,ktz8868.yaml
```yaml
# SPDX-License-Identifier: (GPL-2.0-only OR BSD-2-Clause)
%YAML 1.2
---
$id: http://devicetree.org/schemas/leds/backlight/kinetic,ktz8868.yaml#
$schema: http://devicetree.org/meta-schemas/core.yaml#

title: Kinetic Technologies KTZ8868 backlight pair

maintainers:
  - Travis Geisinger <travis@geisinger.dev>

description: |
  The Kinetic Technologies KTZ8868 is an LED backlight driver with an 11-bit
  brightness and a dual LCD bias supply. The OnePlus Pad 3 lights its panel
  with two of them, on two I2C buses, that take the same settings: the
  primary one, kinetic,ktz8868a, which also feeds the LCD bias, and the
  secondary one, kinetic,ktz8868b. The primary one is the backlight device.

allOf:
  - $ref: common.yaml#

properties:
  compatible:
    enum:
      - kinetic,ktz8868a
      - kinetic,ktz8868b

  reg:
    maxItems: 1

  enable-gpios:
    description: GPIO to the HWEN pin of the primary chip
    maxItems: 1

  vin-supply:
    description: Supply of the boost converters

  vddio-supply:
    description: Supply of the I2C interface

  pinctrl-0: true
  pinctrl-1: true
  pinctrl-names:
    items:
      - const: default
      - const: sleep

required:
  - compatible
  - reg

unevaluatedProperties: false

examples:
  - |
    #include <dt-bindings/gpio/gpio.h>

    i2c {
        #address-cells = <1>;
        #size-cells = <0>;

        backlight@11 {
            compatible = "kinetic,ktz8868a";
            reg = <0x11>;
            enable-gpios = <&tlmm 15 GPIO_ACTIVE_HIGH>;
        };
    };

    i2c {
        #address-cells = <1>;
        #size-cells = <0>;

        backlight@11 {
            compatible = "kinetic,ktz8868b";
            reg = <0x11>;
        };
    };
...
```
