## Documentation/devicetree/bindings/thermal/weighted-thermal-sensor.yaml
```yaml
# SPDX-License-Identifier: (GPL-2.0-only OR BSD-2-Clause)
%YAML 1.2
---
$id: http://devicetree.org/schemas/thermal/weighted-thermal-sensor.yaml#
$schema: http://devicetree.org/meta-schemas/core.yaml#

title: Weighted average of thermal zones

maintainers:
  - Doctor Logix <doctor.logix@gmail.com>

description:
  A thermal sensor whose temperature is a weighted average of other thermal
  zones. Phones estimate the temperature of surfaces that carry no
  thermistor, such as the back cover, this way and throttle charging and
  performance on the estimate.

allOf:
  - $ref: thermal-sensor.yaml#

properties:
  compatible:
    const: weighted-thermal-sensor

  '#thermal-sensor-cells':
    const: 0

  zone-names:
    $ref: /schemas/types.yaml#/definitions/string-array
    description: Names of the thermal zones to average.
    minItems: 1

  weights:
    $ref: /schemas/types.yaml#/definitions/uint32-array
    description:
      Relative weight of each zone in zone-names, in the same order. The
      weights need not add up to any particular total.
    minItems: 1

required:
  - compatible
  - '#thermal-sensor-cells'
  - zone-names
  - weights

unevaluatedProperties: false

examples:
  - |
    thermal-sensor-back {
        compatible = "weighted-thermal-sensor";
        #thermal-sensor-cells = <0>;
        zone-names = "msm-thermal", "pa0-thermal", "cam-thermal", "battery";
        weights = <10 15 15 60>;
    };
...
```

## drivers/gpu/drm/mediatek-dpu/Kconfig
```kconfig
# SPDX-License-Identifier: GPL-2.0-only
config DRM_MEDIATEK_DPU
	tristate "MediaTek Dimensity display processor"
	depends on DRM && OF
	depends on ARCH_MEDIATEK || COMPILE_TEST
	select DRM_CLIENT_SELECTION
	select DRM_KMS_HELPER
	select DRM_GEM_DMA_HELPER
	select DRM_MIPI_DSI
	select DRM_PANEL
	help
	  Choose this option for the display pipeline of MediaTek Dimensity
	  SoCs that split it into overlay (OVL) and display subsystems,
	  such as the MT6897.

	  If M is selected the module will be called mediatek-dpu.
```

## drivers/net/wireless/mediatek/mt76/mt7921/Kconfig
```kconfig
# SPDX-License-Identifier: BSD-3-Clause-Clear
config MT7921_COMMON
	tristate
	select MT792x_LIB
	select WANT_DEV_COREDUMP

config MT7921E
	tristate "MediaTek MT7921E (PCIe) support"
	select MT7921_COMMON
	depends on MAC80211
	depends on PCI
	help
	  This adds support for MT7921E 802.11ax 2x2:2SS wireless devices.

	  To compile this driver as a module, choose M here.

config MT7921_SOC
	bool "MediaTek MT7921 Wi-Fi core of SoCs"
	depends on MT7921E
	depends on ARCH_MEDIATEK || COMPILE_TEST
	depends on MTK_CONSYS=y || MTK_CONSYS=MT7921E
	help
	  This adds support for the MT7921 Wi-Fi core that the connectivity
	  subsystem of MediaTek SoCs such as the MT6897 holds, with firmware
	  that the bootloader loads.

config MT7921S
	tristate "MediaTek MT7921S (SDIO) support"
	select MT76_SDIO
	select MT7921_COMMON
	depends on MAC80211
	depends on MMC
	help
	  This adds support for MT7921S 802.11ax 2x2:2SS wireless devices.

	  To compile this driver as a module, choose M here.

config MT7921U
	tristate "MediaTek MT7921U (USB) support"
	select MT792x_USB
	select MT7921_COMMON
	depends on MAC80211
	depends on USB
	help
	  This adds support for MT7921U 802.11ax 2x2:2SS wireless devices.

	  To compile this driver as a module, choose M here.
```
